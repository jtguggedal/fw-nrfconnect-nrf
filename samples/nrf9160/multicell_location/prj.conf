## Kconfig
```
#
# Copyright (c) 2021 Nordic Semiconductor ASA
#
# SPDX-License-Identifier: LicenseRef-Nordic-5-Clause
#

menu "Multicell location sample"

config MULTICELL_LOCATION_SAMPLE_PERIODIC_SEARCH
	bool "Periodically search for neighbor cells"

config MULTICELL_LOCATION_SAMPLE_PERIODIC_SEARCH_INTERVAL
	int "Periodic search interval [sec]"
	default 60

config MULTICELL_LOCATION_SAMPLE_BUTTON_TRIG_SEARCH
	bool "Trigger neighbor search with button 1"
	default y

config MULTICELL_LOCATION_SAMPLE_PRINT_DATA
	bool "Print multicell data"
	default y
	help
	  Prints cell data when it's reported from the link controller.

config MULTICELL_LOCATION_SAMPLE_PSM
	bool "Enable PSM"

config MULTICELL_LOCATION_SAMPLE_EDRX
	bool "Enable eDRX"

module = MULTICELL_LOCATION_SAMPLE
module-str = Multicell location sample
source "${ZEPHYR_BASE}/subsys/logging/Kconfig.template.log_config"

endmenu

menu "Zephyr Kernel"
source "Kconfig.zephyr"
endmenu
```

## sample.yaml
```
sample:
  name: Multicell location sample
tests:
  samples.nrf9160.multicell_location:
    build_only: true
    build_on_all: true
    platform_allow: nrf9160dk_nrf9160ns thingy91_nrf9160ns
    integration_platforms:
      - nrf9160dk_nrf9160ns
      - thingy91_nrf9160ns
    tags: ci_build
```

## prj.conf
```kconfig
#
# Copyright (c) 2021 Nordic Semiconductor ASA
#
# SPDX-License-Identifier: LicenseRef-Nordic-5-Clause
#

# General config
CONFIG_FPU=y
CONFIG_NEWLIB_LIBC=y
CONFIG_NEWLIB_LIBC_FLOAT_PRINTF=y

# Logging
CONFIG_LOG=y
CONFIG_LOG_MODE_IMMEDIATE=y

# Sample configurations
# CONFIG_MULTICELL_LOCATION_SAMPLE_PERIODIC_SEARCH=y
# CONFIG_MULTICELL_LOCATION_SAMPLE_PERIODIC_SEARCH_INTERVAL=600

# Multicell location
CONFIG_MULTICELL_LOCATION=y
CONFIG_MULTICELL_LOCATION_LOG_LEVEL_DBG=y

# HERE location service configuration
# By default, HERE API v2 with API key authentication is used.
# This can be changed to v1 and app code + app ID authentication using Kconfig
# options.
# CONFIG_MULTICELL_LOCATION_SERVICE_HERE=y
# CONFIG_MULTICELL_LOCATION_HERE_API_KEY=""

# Skyhook location service configuration
# CONFIG_MULTICELL_LOCATION_SERVICE_SKYHOOK=y
# CONFIG_MULTICELL_LOCATION_SKYHOOK_API_KEY=""

# Polte location service configuration
CONFIG_MULTICELL_LOCATION_SERVICE_POLTE=y
CONFIG_MULTICELL_LOCATION_POLTE_CUSTOMER_ID="607701b48e780400125c7868"
CONFIG_MULTICELL_LOCATION_POLTE_API_TOKEN="740f13826ecb61c545235da0af62af64f35e04ac113a4e36524e9e3c3f4ed9d2b"

# Network
CONFIG_NETWORKING=y
CONFIG_NET_NATIVE=n
CONFIG_NET_SOCKETS=y
CONFIG_NET_SOCKETS_OFFLOAD=y

# LTE link control
CONFIG_LTE_LINK_CONTROL=y
CONFIG_LTE_NETWORK_MODE_LTE_M=y
CONFIG_LTE_AUTO_INIT_AND_CONNECT=n
# Request PSM active time of 8 seconds.
CONFIG_LTE_PSM_REQ_RAT="00000100"

# Modem library
CONFIG_NRF_MODEM_LIB=y
CONFIG_MODEM_KEY_MGMT=y
CONFIG_MODEM_INFO=y

# DK
CONFIG_DK_LIBRARY=y

# Heap and stacks
# The AT parser and link controller libraries use the heap
CONFIG_HEAP_MEM_POOL_SIZE=2048

CONFIG_AT_HOST_LIBRARY=y
CONFIG_UART_INTERRUPT_DRIVEN=y


CONFIG_NET_SOCKETS_OFFLOAD_TLS=n
CONFIG_NET_SOCKETS_SOCKOPT_TLS=y

CONFIG_MBEDTLS=y
CONFIG_MBEDTLS_BUILTIN=n
CONFIG_MBEDTLS_ENABLE_HEAP=y
CONFIG_MBEDTLS_HEAP_SIZE=30000
CONFIG_MBEDTLS_SSL_MAX_CONTENT_LEN=4096
# CONFIG_MBEDTLS_PEM_CERTIFICATE_FORMAT=y

CONFIG_LOG=y
CONFIG_NET_LOG=y
CONFIG_NET_SOCKETS_LOG_LEVEL_DBG=y

CONFIG_NORDIC_SECURITY_BACKEND=y

# TLS configuration
CONFIG_MBEDTLS=y
CONFIG_MBEDTLS_LIBRARY=y
CONFIG_MBEDTLS_TLS_LIBRARY=y
CONFIG_MBEDTLS_PKCS1_V15=y
CONFIG_MBEDTLS_INSTALL_PATH="DUMMY"
CONFIG_NORDIC_SECURITY_BACKEND=y
CONFIG_NRF_SECURITY_ADVANCED=y
CONFIG_MBEDTLS_SSL_SERVER_NAME_INDICATION=y
CONFIG_MBEDTLS_AES_C=y
CONFIG_MBEDTLS_GCM_C=y

CONFIG_MAIN_STACK_SIZE=4096
```

## src/main.c
```c
/*
 * Copyright (c) 2021 Nordic Semiconductor ASA
 *
 * SPDX-License-Identifier: LicenseRef-Nordic-5-Clause
 */

#include <zephyr.h>
#include <stdio.h>
#include <modem/lte_lc.h>
#include <dk_buttons_and_leds.h>
#include <net/multicell_location.h>

#include <logging/log.h>

LOG_MODULE_REGISTER(multicell_location_sample, CONFIG_MULTICELL_LOCATION_SAMPLE_LOG_LEVEL);

BUILD_ASSERT(!IS_ENABLED(CONFIG_LTE_AUTO_INIT_AND_CONNECT),
	"The sample does not support automatic LTE connection establishment");

static K_SEM_DEFINE(lte_connected, 0, 1);
static K_SEM_DEFINE(cell_data_ready, 0, 1);
static struct k_work_delayable periodic_search_work;
static struct lte_lc_ncell neighbor_cells[17];
static struct lte_lc_cells_info cell_data = {
	.neighbor_cells = neighbor_cells,
};

static void lte_handler(const struct lte_lc_evt *const evt)
{
	switch (evt->type) {
	case LTE_LC_EVT_NW_REG_STATUS:
		if ((evt->nw_reg_status != LTE_LC_NW_REG_REGISTERED_HOME) &&
		     (evt->nw_reg_status != LTE_LC_NW_REG_REGISTERED_ROAMING)) {
			break;
		}

		LOG_INF("Network registration status: %s",
			evt->nw_reg_status == LTE_LC_NW_REG_REGISTERED_HOME ?
			"Connected - home network" : "Connected - roaming");
		k_sem_give(&lte_connected);
		break;
	case LTE_LC_EVT_PSM_UPDATE:
		LOG_INF("PSM parameter update: TAU: %d, Active time: %d",
			evt->psm_cfg.tau, evt->psm_cfg.active_time);
		break;
	case LTE_LC_EVT_EDRX_UPDATE: {
		char log_buf[60];
		ssize_t len;

		len = snprintk(log_buf, sizeof(log_buf),
			       "eDRX parameter update: eDRX: %f, PTW: %f",
			       evt->edrx_cfg.edrx, evt->edrx_cfg.ptw);
		if (len > 0) {
			LOG_INF("%s", log_strdup(log_buf));
		}
		break;
	}
	case LTE_LC_EVT_RRC_UPDATE:
		LOG_INF("RRC mode: %s",
			evt->rrc_mode == LTE_LC_RRC_MODE_CONNECTED ?
			"Connected" : "Idle");
		break;
	case LTE_LC_EVT_CELL_UPDATE:
		LOG_INF("LTE cell changed: Cell ID: %d, Tracking area: %d",
			evt->cell.id, evt->cell.tac);
		break;
	case LTE_LC_EVT_LTE_MODE_UPDATE:
		LOG_INF("Active LTE mode changed: %s",
			evt->lte_mode == LTE_LC_LTE_MODE_NONE ? "None" :
			evt->lte_mode == LTE_LC_LTE_MODE_LTEM ? "LTE-M" :
			evt->lte_mode == LTE_LC_LTE_MODE_NBIOT ? "NB-IoT" :
			"Unknown");
		break;
	case LTE_LC_EVT_NEIGHBOR_CELL_MEAS:
		LOG_INF("Neighbor cell measurements received");

		/* Copy current and neighbor cell information. */
		memcpy(&cell_data, &evt->cells_info, sizeof(struct lte_lc_cells_info));
		memcpy(neighbor_cells, evt->cells_info.neighbor_cells,
			sizeof(struct lte_lc_ncell) * cell_data.ncells_count);
		cell_data.neighbor_cells = neighbor_cells;

		k_sem_give(&cell_data_ready);
		break;
	default:
		break;
	}
}

static int lte_connect(void)
{
	int err;

	if (IS_ENABLED(CONFIG_MULTICELL_LOCATION_SAMPLE_PSM)) {
		err = lte_lc_psm_req(true);
		if (err) {
			LOG_ERR("Failed to request PSM, error: %d", err);
		}
	} else {
		err = lte_lc_psm_req(false);
		if (err) {
			LOG_ERR("Failed to disable PSM, error: %d", err);
		}
	}

	if (IS_ENABLED(CONFIG_MULTICELL_LOCATION_SAMPLE_EDRX)) {
		err = lte_lc_edrx_req(true);
		if (err) {
			LOG_ERR("Failed to request eDRX, error: %d", err);
		}
	} else {
		err = lte_lc_edrx_req(false);
		if (err) {
			LOG_ERR("Failed to disable eDRX, error: %d", err);
		}
	}

	err = lte_lc_init_and_connect_async(lte_handler);
	if (err) {
		LOG_ERR("Modem could not be configured, error: %d",
			err);
		return err;
	}

	/* Check LTE events of type LTE_LC_EVT_NW_REG_STATUS in
		* lte_handler() to determine when the LTE link is up.
		*/

	return 0;
}

static void button_handler(uint32_t button_states, uint32_t has_changed)
{
	if (has_changed & button_states & DK_BTN1_MSK) {
		int err = lte_lc_neighbor_cell_measurement();

		if (err) {
			LOG_ERR("Failed to initiate neighbor cell measurements");
		}
	}
}

static void periodic_search_work_fn(struct k_work *work)
{
	int err = lte_lc_neighbor_cell_measurement();

	if (err) {
		LOG_ERR("Failed to initiate neighbor cell measurements");
	}

	k_work_reschedule(k_work_delayable_from_work(work),
		K_SECONDS(CONFIG_MULTICELL_LOCATION_SAMPLE_PERIODIC_SEARCH_INTERVAL));
}

static void print_cell_data(void)
{
	if (cell_data.current_cell.id == 0) {
		LOG_WRN("No cells were found");
		return;
	}

	LOG_INF("Current cell:");
	LOG_INF("\tMCC: %03d", cell_data.current_cell.mcc);
	LOG_INF("\tMNC: %03d", cell_data.current_cell.mnc);
	LOG_INF("\tCell ID: %d", cell_data.current_cell.id);
	LOG_INF("\tTAC: %d", cell_data.current_cell.tac);
	LOG_INF("\tEARFCN: %d", cell_data.current_cell.earfcn);
	LOG_INF("\tTiming advance: %d", cell_data.current_cell.timing_advance);
	LOG_INF("\tMeasurement time: %lld", cell_data.current_cell.measurement_time);
	LOG_INF("\tPhysical cell ID: %d", cell_data.current_cell.phys_cell_id);
	LOG_INF("\tRSRP: %d", cell_data.current_cell.rsrp);
	LOG_INF("\tRSRQ: %d", cell_data.current_cell.rsrq);

	if (cell_data.ncells_count == 0) {
		LOG_INF("*** No neighbor cells found ***");
		return;
	}

	for (size_t i = 0; i < cell_data.ncells_count; i++) {
		LOG_INF("Neighbor cell %d", i + 1);
		LOG_INF("\tEARFCN: %d", cell_data.neighbor_cells[i].earfcn);
		LOG_INF("\tTime difference: %d", cell_data.neighbor_cells[i].time_diff);
		LOG_INF("\tPhysical cell ID: %d", cell_data.neighbor_cells[i].phys_cell_id);
		LOG_INF("\tRSRP: %d", cell_data.neighbor_cells[i].rsrp);
		LOG_INF("\tRSRQ: %d", cell_data.neighbor_cells[i].rsrq);
	}
}



#include <soc.h>
#include <nrfx.h>

void modem_trace_enable(void)
{
    /* GPIO configurations for trace and debug */
    #define CS_PIN_CFG_TRACE_CLK    21 //GPIO_OUT_PIN21_Pos
    #define CS_PIN_CFG_TRACE_DATA0  22 //GPIO_OUT_PIN22_Pos
    #define CS_PIN_CFG_TRACE_DATA1  23 //GPIO_OUT_PIN23_Pos
    #define CS_PIN_CFG_TRACE_DATA2  24 //GPIO_OUT_PIN24_Pos
    #define CS_PIN_CFG_TRACE_DATA3  25 //GPIO_OUT_PIN25_Pos

    NRF_GPIO_Type *port = NRF_P0_NS;

    // Configure outputs.
    // CS_PIN_CFG_TRACE_CLK
    port->PIN_CNF[CS_PIN_CFG_TRACE_CLK] = (GPIO_PIN_CNF_DRIVE_H0H1 << GPIO_PIN_CNF_DRIVE_Pos) |
                                                (GPIO_PIN_CNF_INPUT_Disconnect << GPIO_PIN_CNF_INPUT_Pos);

    // CS_PIN_CFG_TRACE_DATA0
    port->PIN_CNF[CS_PIN_CFG_TRACE_DATA0] = (GPIO_PIN_CNF_DRIVE_H0H1 << GPIO_PIN_CNF_DRIVE_Pos) |
                                                  (GPIO_PIN_CNF_INPUT_Disconnect << GPIO_PIN_CNF_INPUT_Pos);

    // CS_PIN_CFG_TRACE_DATA1
    port->PIN_CNF[CS_PIN_CFG_TRACE_DATA1] = (GPIO_PIN_CNF_DRIVE_H0H1 << GPIO_PIN_CNF_DRIVE_Pos) |
                                                  (GPIO_PIN_CNF_INPUT_Disconnect << GPIO_PIN_CNF_INPUT_Pos);

    // CS_PIN_CFG_TRACE_DATA2
    port->PIN_CNF[CS_PIN_CFG_TRACE_DATA2] = (GPIO_PIN_CNF_DRIVE_H0H1 << GPIO_PIN_CNF_DRIVE_Pos) |
                                                  (GPIO_PIN_CNF_INPUT_Disconnect << GPIO_PIN_CNF_INPUT_Pos);

    // CS_PIN_CFG_TRACE_DATA3
    port->PIN_CNF[CS_PIN_CFG_TRACE_DATA3] = (GPIO_PIN_CNF_DRIVE_H0H1 << GPIO_PIN_CNF_DRIVE_Pos) |
                                                  (GPIO_PIN_CNF_INPUT_Disconnect << GPIO_PIN_CNF_INPUT_Pos);

    port->DIR = 0xFFFFFFFF;

    printk("Traces enabled\n");
}


void main(void)
{
	int err;
	struct multicell_location location;

	LOG_INF("Multicell location sample has started");
	modem_trace_enable();

	k_work_init_delayable(&periodic_search_work, periodic_search_work_fn);

	err = multicell_location_provision_certificate(false);
	if (err) {
		LOG_ERR("Certificate provisioning failed, exiting application");
		return;
	}

	err = dk_buttons_init(button_handler);
	if (err) {
		LOG_ERR("Failed to initialize DK library, error: %d", err);
	}

	err = lte_connect();
	if (err) {
		LOG_ERR("Failed to connect to LTE network, error: %d", err);
		return;
	}

	LOG_INF("Connecting to LTE network, this may take several minutes...");

	k_sem_take(&lte_connected, K_FOREVER);

	LOG_INF("Connected to LTE network");

	if (IS_ENABLED(CONFIG_MULTICELL_LOCATION_SAMPLE_PERIODIC_SEARCH)) {
		LOG_INF("Requesting neighbor cell information every %d seconds",
			CONFIG_MULTICELL_LOCATION_SAMPLE_PERIODIC_SEARCH_INTERVAL);
		k_work_schedule(&periodic_search_work, K_NO_WAIT);
	}

	while (true) {
		k_sem_take(&cell_data_ready, K_FOREVER);

		if (CONFIG_MULTICELL_LOCATION_SAMPLE_PRINT_DATA) {
			print_cell_data();
		}

		LOG_INF("Sending location request...");

		err = multicell_location_get(&cell_data, &location);
		if (err) {
			LOG_ERR("Failed to acquire location, error: %d", err);
			continue;
		}

		LOG_INF("Location obtained: ");
		LOG_INF("\tLatitude: %f", location.latitude);
		LOG_INF("\tLongitude: %f", location.longitude);
		LOG_INF("\tAccuracy: %.0f", location.accuracy);
	}
}
```
