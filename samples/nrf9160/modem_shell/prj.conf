## CMakeLists.txt
```
#
# Copyright (c) 2020 Nordic Semiconductor
#
# SPDX-License-Identifier: LicenseRef-Nordic-5-Clause
#

cmake_minimum_required(VERSION 3.20.0)

find_package(Zephyr REQUIRED HINTS $ENV{ZEPHYR_BASE})
project(MOSH)
target_include_directories(app PRIVATE
  ${CMAKE_CURRENT_SOURCE_DIR}/src
  ${CMAKE_CURRENT_SOURCE_DIR}/iperf
  ${CMAKE_CURRENT_SOURCE_DIR}/ping
  ${CMAKE_CURRENT_SOURCE_DIR}/utils)

target_sources(app PRIVATE src/main.c)
target_sources(app PRIVATE src/shell.c)

add_subdirectory(src/print)
add_subdirectory(src/utils)
add_subdirectory(src/uart)
add_subdirectory(src/at)
add_subdirectory(src/modem_trace)
add_subdirectory_ifdef(CONFIG_MOSH_NRF91_NON_OFFLOADING_DEV src/drivers)
add_subdirectory_ifdef(CONFIG_MOSH_WORKER_THREADS src/th)
add_subdirectory_ifdef(CONFIG_MOSH_SOCK src/sock)
add_subdirectory_ifdef(CONFIG_MOSH_LINK src/link)
add_subdirectory_ifdef(CONFIG_MOSH_PING src/ping)
add_subdirectory_ifdef(CONFIG_MOSH_GNSS src/gnss)
add_subdirectory_ifdef(CONFIG_MOSH_SMS src/sms)
add_subdirectory_ifdef(CONFIG_MOSH_LOCATION src/location)
add_subdirectory_ifdef(CONFIG_MOSH_PPP src/ppp)
add_subdirectory_ifdef(CONFIG_MOSH_FOTA src/fota)
add_subdirectory_ifdef(CONFIG_MOSH_REST src/rest)
add_subdirectory_ifdef(CONFIG_MOSH_STARTUP_CMDS src/startup_cmd)
add_subdirectory(src/cloud)

zephyr_include_directories(config)

if(NOT ENV{PROJECT_NAME})
  zephyr_compile_definitions(
    PROJECT_NAME=${CMAKE_PROJECT_NAME}
  )
endif()
```

## Kconfig
```
#
# Copyright (c) 2020 Nordic Semiconductor ASA
#
# SPDX-License-Identifier: LicenseRef-Nordic-5-Clause
#

source "Kconfig.zephyr"

menu "Nordic Modem Shell config"

config MOSH_IPERF3
	bool "iPerf3"
	default y
	select NRF_IPERF3

config NRF_IPERF3_PROMPTLESS
	bool
	default y

config MOSH_SOCK
	bool "Socket tool"
	default y
	help
	  Socket tool with TCP, UDP, RAW, IPv4, IPv6 and packet socket support.

config MOSH_PING
	bool "ICMP ping"
	default y
	help
	  Ping is a tool for testing the reachability of a host on an IP network.

config MOSH_LINK
	bool "Link control"
	depends on LTE_LINK_CONTROL
	depends on MODEM_INFO
	depends on SETTINGS
	default y
	help
	  Link control changes and queries the state of the LTE connection.

config MOSH_CURL
	bool "cURL"
	default y
	select NRF_CURL

config NRF_CURL_PROMPTLESS
	bool
	default y

config MOSH_GNSS
	bool "GNSS"
	default y
	help
	  GNSS feature for searching the location of the device.

config MOSH_PPP
	bool "PPP"
	help
	  Point-to-Point Protocol for enabling dial-up access to the Internet.

config MOSH_SMS
	bool "SMS"
	default y
	help
	  SMS tool for sending and receiving SMS messages.

config MOSH_LOCATION
	bool "Location"
	default y
	select LOCATION
	help
	  Tool for location queries via location library.

config MOSH_FOTA
	bool "FOTA"
	default y
	help
	  FOTA for performing software updates over-the-air for both modem and application side.

config MOSH_REST
	bool "REST client"
	default y
	select REST_CLIENT
	help
	  REST client for sending and receiving simple REST requests/responses.

config MOSH_CLOUD_REST
	bool "nRFCloud commands over REST"
	default y
	select NRF_CLOUD_REST
	select MODEM_JWT
	select NRF_CLOUD_AGPS_FILTERED if NRF_CLOUD_AGPS && !NRF_CLOUD_MQTT
	select NRF_CLOUD_AGPS_FILTERED_RUNTIME if NRF_CLOUD_AGPS && !NRF_CLOUD_MQTT

config MOSH_CLOUD_MQTT
	bool "MQTT connection to nRFCloud"
	select NRF_CLOUD_MQTT
	select NRF_CLOUD_LOCATION if MULTICELL_LOCATION_SERVICE_NRF_CLOUD
	help
	  MQTT connection to nRFCloud.

config MOSH_CLOUD_LWM2M
	bool "Cloud connection using LwM2M"
	help
	  Cloud connection using LwM2M.

config MOSH_AT_CMD_MODE
	bool "Specific AT command mode"
	default y

config MOSH_PRINT_BUFFER_SIZE
	int "Buffer size used when printing modem shell output"
	default 1024
	help
	  If the printed string exceeds this buffer, an error message is printed first and
	  then the requested string cut into the length of this buffer.

config MOSH_COMMON_WORKQUEUE_STACK_SIZE
	int "Common workqueue stack size"
	default 6144 if MOSH_STARTUP_CMDS && MOSH_CURL
	default 4096

config MOSH_COMMON_WORKQUEUE_PRIORITY
	int "Common workqueue priority"
	default 5

if MOSH_IPERF3 || MOSH_PING
menu "MoSH iperf3 and ping command selections"

config MOSH_WORKER_THREADS
	bool "Possibility to run iperf3 or ping instances in separate threads"
	default y

config MOSH_STARTUP_CMDS
	bool "Possibility to run stored MoSh commands from settings after bootup"
	default y

config MOSH_NRF91_NON_OFFLOADING_DEV
	bool "Possibility to run iperf3 with Zephyr TCP/IP stack"

endmenu
endif

if MOSH_AT_CMD_MODE
choice
	prompt "Command termination"
	default MOSH_AT_CMD_MODE_CR_LF_TERMINATION
	help
		Sets the command termination ending from the serial terminal
		Levels are:
		-  NULL Termination
		-  CR Termination
		-  LF Termination
		-  CR+LF Termination
	config MOSH_AT_CMD_MODE_NULL_TERMINATION
		bool "NULL Termination"
	config MOSH_AT_CMD_MODE_CR_TERMINATION
		bool "CR Termination"
	config MOSH_AT_CMD_MODE_LF_TERMINATION
		bool "LF Termination"
	config MOSH_AT_CMD_MODE_CR_LF_TERMINATION
		bool "CR+LF Termination"
endchoice
config MOSH_AT_CMD_MODE_TERMINATION
	int
	default 0 if MOSH_AT_CMD_MODE_NULL_TERMINATION
	default 1 if MOSH_AT_CMD_MODE_CR_TERMINATION
	default 2 if MOSH_AT_CMD_MODE_LF_TERMINATION
	default 3 if MOSH_AT_CMD_MODE_CR_LF_TERMINATION
endif

if MOSH_LINK
menu "MoSH link control selections"

config MOSH_LINK_SETT_NORMAL_MODE_AT_CMD_STR_LEN
	int "Link settings AT command length"
	default 127
	help
	  String length for custom AT commands stored into settings to be used
	  when going to normal mode.

endmenu
endif #MOSH_LINK

if MOSH_WORKER_THREADS

config MOSH_WORKER_THREADS_OUTPUT_BUFFER_SIZE
	int "Buffer size for storing output of the background thread commands"
	default 4096

config MOSH_WORKER_THREADS_STACK_SIZE
	int "Worker thread stack size"
	default 4096

endif #MOSH_WORKER_THREADS

if MOSH_CLOUD_LWM2M

config MOSH_LWM2M_PSK
	string "LwM2M pre-shared key for communication"
	default "000102030405060708090a0b0c0d0e0f"
	help
	  Pre-shared key must be identical to the PSK registered with the device on the LwM2M server.
	  Use the hexadecimal representation.

config MOSH_LWM2M_ENDPOINT_PREFIX
	string "Prefix used in the LwM2M endpoint name"
	default "urn:imei:"
	help
	  Sets the prefix of the endpoint name used when connecting to the LwM2M server.

endif # MOSH_CLOUD_LWM2M

rsource "src/modem_trace/Kconfig.trace_flash"
rsource "src/modem_trace/Kconfig.trace_storage"

endmenu # Modem Shell
```

## prj.conf
```kconfig
#
# Copyright (c) 2020 Nordic Semiconductor ASA
#
# SPDX-License-Identifier: LicenseRef-Nordic-5-Clause
#
# General config

CONFIG_MOSH_IPERF3=y
CONFIG_MOSH_SOCK=y
CONFIG_MOSH_PING=y
CONFIG_MOSH_CURL=y
CONFIG_MOSH_LINK=y
CONFIG_MOSH_SMS=y
CONFIG_MOSH_GNSS=y
CONFIG_MOSH_LOCATION=y

# Stacks and heaps
CONFIG_MAIN_STACK_SIZE=4096
CONFIG_HEAP_MEM_POOL_SIZE=8192

# System queue is used e.g. by AT monitor and SMS lib
CONFIG_SYSTEM_WORKQUEUE_STACK_SIZE=2048

# Shell configurations
CONFIG_SHELL=y
CONFIG_SHELL_WILDCARD=n
CONFIG_SHELL_PROMPT_UART="mosh:~$ "
CONFIG_SHELL_ARGC_MAX=40
# Command line buffer is set this large to enable writing of certificates and injecting A-GPS data on command line.
CONFIG_SHELL_CMD_BUFF_SIZE=3584
# Shell stack has impact for modem shell application, not CONFIG_MAIN_STACK_SIZE
CONFIG_SHELL_STACK_SIZE=9216
# Shell RX buffer needs to be increased to avoid problems with test automation
CONFIG_SHELL_BACKEND_SERIAL_RX_RING_BUFFER_SIZE=512
# LTE shell is unnecessary with Modem Shell
CONFIG_LTE_SHELL=n
# Enable use of vsnprintfcb() for extending mosh_print() format
CONFIG_CBPRINTF_LIBC_SUBSTS=y

CONFIG_MINIMAL_LIBC=n
CONFIG_NEWLIB_LIBC=y
CONFIG_NEWLIB_LIBC_FLOAT_SCANF=y
CONFIG_NEWLIB_LIBC_FLOAT_PRINTF=y
CONFIG_FPU=y
CONFIG_CJSON_LIB=y

# Getopt
CONFIG_GETOPT_LIB=y

# Device power management
CONFIG_PM_DEVICE=y

# Modem info
CONFIG_MODEM_INFO=y

# Modem key management
CONFIG_MODEM_KEY_MGMT=y

# Network
CONFIG_NETWORKING=y
CONFIG_NET_NATIVE=n
CONFIG_NET_SOCKETS=y
CONFIG_NET_SOCKETS_OFFLOAD=y
CONFIG_NET_SOCKETS_POSIX_NAMES=n
# Native IPv6 is enabled by default, disable it because we don't need it
CONFIG_NET_IPV6=n

CONFIG_POSIX_API=y
CONFIG_PTHREAD_IPC=n # There are issues with posix api if this is set
CONFIG_POSIX_MAX_FDS=10
# Need to be the same as MAX_FDS
CONFIG_NET_SOCKETS_POLL_MAX=10

# Modem library
CONFIG_NRF_MODEM_LIB=y
CONFIG_NRF_MODEM_LIB_SHMEM_TX_SIZE=22528
CONFIG_NRF_MODEM_LIB_SHMEM_RX_SIZE=8192
CONFIG_NRF_MODEM_LIB_ON_FAULT_APPLICATION_SPECIFIC=y
# Enable modem UART traces
CONFIG_NRF_MODEM_LIB_TRACE=n

# AT monitor library
CONFIG_AT_MONITOR=y

# Increase AT monitor heap because %NCELLMEAS notifications can be long.
# Note: with legacy NCELLMEAS types, 512 is enough, but with GCI search types
# it could be even longer: theoretical maximum of 4020 bytes.
CONFIG_AT_MONITOR_HEAP_SIZE=4096

# PDN library
CONFIG_PDN=y
CONFIG_PDN_ESM_STRERROR=y

# SMS
CONFIG_SMS=y

# LTE link control
CONFIG_LTE_LINK_CONTROL=y
CONFIG_LTE_NETWORK_MODE_LTE_M_GPS=y
CONFIG_LTE_MODE_PREFERENCE_AUTO=y

CONFIG_LTE_AUTO_INIT_AND_CONNECT=n
CONFIG_LTE_NETWORK_USE_FALLBACK=n

#MOSH is having own commands to enable these at runtime:
CONFIG_LTE_LC_MODEM_SLEEP_NOTIFICATIONS=n
CONFIG_LTE_LC_TAU_PRE_WARNING_NOTIFICATIONS=n

#Minimum values for thresholds:
CONFIG_LTE_LC_TAU_PRE_WARNING_THRESHOLD_MS=10240
CONFIG_LTE_LC_MODEM_SLEEP_NOTIFICATIONS_THRESHOLD_MS=10240

# Configurations useful for debugging and development that user can enable when needed
#CONFIG_LTE_LOCK_PLMN=y
#CONFIG_LTE_LOCK_PLMN_STRING="24488"
#CONFIG_LTE_NETWORK_MODE_LTE_M_GPS=y

CONFIG_DATE_TIME=y

# nRF Cloud A-GPS, disable this in case you want to enable SUPL below
CONFIG_NRF_CLOUD_AGPS=y

# SUPL A-GPS support, needs the nRF9160 SiP SUPL client library from nRF9160 DK product page
#CONFIG_SUPL_CLIENT_LIB=y

# Cellular positioning
CONFIG_MULTICELL_LOCATION=y
CONFIG_LTE_NEIGHBOR_CELLS_MAX=17

# Cellular positioning services
CONFIG_MULTICELL_LOCATION_SERVICE_NRF_CLOUD=y

#CONFIG_MULTICELL_LOCATION_SERVICE_HERE=y
#CONFIG_MULTICELL_LOCATION_HERE_API_KEY="api key"

# Library for buttons and LEDs
CONFIG_DK_LIBRARY=y

# FOTA
CONFIG_FLASH=y
CONFIG_REBOOT=y
CONFIG_DFU_TARGET=y
CONFIG_FOTA_DOWNLOAD=y
CONFIG_DOWNLOAD_CLIENT=y
# BOOTLOADER_MCUBOOT reduces usable flash size by half so it's disabled by default
# This means application FOTA is disabled. Modem FOTA works without these.
CONFIG_BOOTLOADER_MCUBOOT=n
CONFIG_IMG_MANAGER=n
CONFIG_IMG_ERASE_PROGRESSIVELY=n

# Debugging configurations
CONFIG_FLASH=y
CONFIG_FLASH_MAP=y
CONFIG_MPU_ALLOW_FLASH_WRITE=y
CONFIG_NVS=y
CONFIG_SETTINGS=y
CONFIG_SETTINGS_NVS=y
CONFIG_NVS_LOG_LEVEL_WRN=y

CONFIG_ASSERT=y
CONFIG_LOG=y
CONFIG_DEBUG_INFO=y
#CONFIG_DEBUG_OPTIMIZATIONS=y
#CONFIG_NO_OPTIMIZATIONS=y
#CONFIG_FORCE_NO_ASSERT=y
CONFIG_ASSERT_VERBOSE=y
#CONFIG_ASSERT_LEVEL=2
#CONFIG_ASSERT_ON_ERRORS=y
#CONFIG_FAULT_DUMP=2
CONFIG_RESET_ON_FATAL_ERROR=n
CONFIG_EXTRA_EXCEPTION_INFO=y
#CONFIG_WATCHDOG=y
# Modem trace
CONFIG_NRF_MODEM_LIB_TRACE=y
CONFIG_NRF_MODEM_LIB_TRACE_BACKEND_FLASH=y
CONFIG_NRF_MODEM_LIB_SYS_INIT=n

CONFIG_LOG=y
CONFIG_NRF_MODEM_LIB_LOG_LEVEL_DBG=y
CONFIG_FLASH_LOG_LEVEL_DBG=y
CONFIG_MODEM_TRACE_FLASH_BACKEND_LOG_LEVEL_DBG=y
CONFIG_MODEM_TRACE_STORAGE_LOG_LEVEL_DBG=y

CONFIG_MEMFAULT=y
CONFIG_MEMFAULT_NCS_PROJECT_KEY=""

CONFIG_MEMFAULT_HTTP_PERIODIC_UPLOAD=n
CONFIG_MEMFAULT_NCS_LTE_METRICS=y
CONFIG_MEMFAULT_LOGGING_ENABLE=y
CONFIG_MEMFAULT_LOG_LEVEL_DBG=y
CONFIG_MEMFAULT_ROOT_CERT_STORAGE_NRF9160_MODEM=y
CONFIG_MODEM_KEY_MGMT=y

CONFIG_RESET_ON_FATAL_ERROR=n
CONFIG_ASSERT=y

CONFIG_HEAP_MEM_POOL_SIZE=8092
CONFIG_MAIN_STACK_SIZE=8092
CONFIG_SYSTEM_WORKQUEUE_STACK_SIZE=8092
CONFIG_NRF_MODEM_LIB_TRACE_STACK_SIZE=32840

CONFIG_STREAM_FLASH=y
```

## src/main.c
```c
/*
 * Copyright (c) 2020 Nordic Semiconductor ASA
 *
 * SPDX-License-Identifier: LicenseRef-Nordic-5-Clause
 */

#include <stdio.h>
#include <string.h>

#include <zephyr/kernel.h>
#include <zephyr/init.h>
#include <nrf_modem.h>

#include <sys/types.h>
#include <zephyr/logging/log_ctrl.h>
#include <zephyr/sys/reboot.h>
#include <zephyr/dfu/mcuboot.h>

#include <zephyr/shell/shell.h>
#if defined(CONFIG_SHELL_BACKEND_SERIAL)
#include <zephyr/shell/shell_uart.h>
#else
#include <zephyr/shell/shell_rtt.h>
#endif

#include <modem/nrf_modem_lib.h>
#include <modem/at_monitor.h>
#include <modem/modem_info.h>
#include <modem/lte_lc.h>

#include <net/nrf_cloud_os.h>

#include <dk_buttons_and_leds.h>
#include "uart/uart_shell.h"

#if defined(CONFIG_MOSH_PPP)
#include "ppp_ctrl.h"
#endif

#if defined(CONFIG_MOSH_LINK)
#include "link.h"
#endif

#if defined(CONFIG_MOSH_GNSS)
#include "gnss.h"
#endif

#if defined(CONFIG_MOSH_FOTA)
#include "fota.h"
#endif
#if defined(CONFIG_MOSH_WORKER_THREADS)
#include "th/th_ctrl.h"
#endif
#include "mosh_defines.h"
#include "mosh_print.h"

#if defined(CONFIG_MOSH_LOCATION)
#include "location_shell.h"
#endif

#if defined(CONFIG_MOSH_STARTUP_CMDS)
#include "startup_cmd_ctrl.h"
#endif

#if defined(CONFIG_MOSH_AT_CMD_MODE)
#include "at_cmd_mode.h"
#include "at_cmd_mode_sett.h"
#endif

BUILD_ASSERT(IS_ENABLED(CONFIG_SHELL_BACKEND_SERIAL) || IS_ENABLED(CONFIG_SHELL_BACKEND_RTT),
	     "CONFIG_SHELL_BACKEND_SERIAL or CONFIG_SHELL_BACKEND_RTT shell backend must be "
	     "enabled");

/***** Work queue and work item definitions *****/

#define MOSH_COMMON_WORKQ_PRIORITY CONFIG_MOSH_COMMON_WORKQUEUE_PRIORITY
K_THREAD_STACK_DEFINE(mosh_common_workq_stack, CONFIG_MOSH_COMMON_WORKQUEUE_STACK_SIZE);
struct k_work_q mosh_common_work_q;

/* Global variables */
const struct shell *mosh_shell;
struct k_poll_signal mosh_signal;

char mosh_at_resp_buf[MOSH_AT_CMD_RESPONSE_MAX_LEN];
K_MUTEX_DEFINE(mosh_at_resp_buf_mutex);

K_SEM_DEFINE(mosh_carrier_lib_initialized, 0, 1);

static const char *modem_crash_reason_get(uint32_t reason)
{
	switch (reason) {
	case NRF_MODEM_FAULT_UNDEFINED:
		return "Undefined fault";

	case NRF_MODEM_FAULT_HW_WD_RESET:
		return "HW WD reset";

	case NRF_MODEM_FAULT_HARDFAULT:
		return "Hard fault";

	case NRF_MODEM_FAULT_MEM_MANAGE:
		return "Memory management fault";

	case NRF_MODEM_FAULT_BUS:
		return "Bus fault";

	case NRF_MODEM_FAULT_USAGE:
		return "Usage fault";

	case NRF_MODEM_FAULT_SECURE_RESET:
		return "Secure control reset";

	case NRF_MODEM_FAULT_PANIC_DOUBLE:
		return "Error handler crash";

	case NRF_MODEM_FAULT_PANIC_RESET_LOOP:
		return "Reset loop";

	case NRF_MODEM_FAULT_ASSERT:
		return "Assert";

	case NRF_MODEM_FAULT_PANIC:
		return "Unconditional SW reset";

	case NRF_MODEM_FAULT_FLASH_ERASE:
		return "Flash erase fault";

	case NRF_MODEM_FAULT_FLASH_WRITE:
		return "Flash write fault";

	case NRF_MODEM_FAULT_POFWARN:
		return "Undervoltage fault";

	case NRF_MODEM_FAULT_THWARN:
		return "Overtemperature fault";

	default:
		return "Unknown reason";
	}
}

void nrf_modem_fault_handler(struct nrf_modem_fault_info *fault_info)
{
	printk("Modem crash reason: 0x%x (%s), PC: 0x%x\n",
		fault_info->reason,
		modem_crash_reason_get(fault_info->reason),
		fault_info->program_counter);

	__ASSERT(false, "Modem crash detected, halting application execution");
}

NRF_MODEM_LIB_ON_INIT(modem_shell_init_hook, on_modem_lib_init, NULL);

/* Initialized to value different than success (0) */
static int modem_lib_init_result = -1;

static void on_modem_lib_init(int ret, void *ctx)
{
	modem_lib_init_result = ret;
}

static void mosh_print_version_info(void)
{
#if defined(APP_VERSION)
	printk("\nMOSH version:       %s", STRINGIFY(APP_VERSION));
#else
	printk("\nMOSH version:       unknown");
#endif

#if defined(BUILD_ID)
	printk("\nMOSH build id:      v%s", STRINGIFY(BUILD_ID));
#else
	printk("\nMOSH build id:      custom");
#endif

#if defined(BUILD_VARIANT)
#if defined(BRANCH_NAME)
	printk("\nMOSH build variant: %s/%s\n\n", STRINGIFY(BRANCH_NAME), STRINGIFY(BUILD_VARIANT));
#else
	printk("\nMOSH build variant: %s\n\n", STRINGIFY(BUILD_VARIANT));
#endif
#else
	printk("\nMOSH build variant: dev\n\n");
#endif
}

#if defined(CONFIG_DK_LIBRARY)
static void button_handler(uint32_t button_states, uint32_t has_changed)
{
	if (has_changed & button_states & DK_BTN1_MSK) {
		mosh_print("Button 1 pressed - raising a kill signal");
		k_poll_signal_raise(&mosh_signal, MOSH_SIGNAL_KILL);
#if defined(CONFIG_MOSH_WORKER_THREADS)
		th_ctrl_kill_em_all();
#endif
	} else if (has_changed & ~button_states & DK_BTN1_MSK) {
		mosh_print("Button 1 released - resetting a kill signal");
		k_poll_signal_reset(&mosh_signal);
	}

	if (has_changed & button_states & DK_BTN2_MSK) {
		/* printk() used instead of mosh_print() which returns before the printing is
		 * actually finished and UART gets shut down in the meantime causing a jam.
		 */
		printk("\nButton 2 pressed, toggling UART power state\n");
		uart_toggle_power_state();
	}
}
#endif

void main(void)
{
	int err;
	struct k_work_queue_config cfg = {
		.name = "mosh_common_workq",
	};

#if defined(CONFIG_SHELL_BACKEND_SERIAL)
	mosh_shell = shell_backend_uart_get_ptr();
#else
	mosh_shell = shell_backend_rtt_get_ptr();
#endif

	__ASSERT(mosh_shell != NULL, "Failed to get shell backend");

	mosh_print_version_info();

#if defined(CONFIG_NRF_CLOUD_REST) || defined(CONFIG_NRF_CLOUD_MQTT)
#if defined(CONFIG_MOSH_IPERF3)
	/* Due to iperf3, we cannot let nrf cloud lib to initialize cJSON lib to be
	 * using kernel heap allocations (i.e. k_ prepending functions).
	 * Thus, we use standard c alloc/free, i.e. "system heap".
	 */
	struct nrf_cloud_os_mem_hooks hooks = {
		.malloc_fn = malloc,
		.calloc_fn = calloc,
		.free_fn = free,
	};
#else
	/* else: we default to Kernel heap */
	struct nrf_cloud_os_mem_hooks hooks = {
		.malloc_fn = k_malloc,
		.calloc_fn = k_calloc,
		.free_fn = k_free,
	};
#endif

	nrf_cloud_os_mem_hooks_init(&hooks);
#endif

	k_work_queue_start(
		&mosh_common_work_q,
		mosh_common_workq_stack,
		K_THREAD_STACK_SIZEOF(mosh_common_workq_stack),
		MOSH_COMMON_WORKQ_PRIORITY,
		&cfg);

#if !defined(CONFIG_LWM2M_CARRIER)
	/* Get Modem library initialization return value. */
	err = nrf_modem_lib_init(NORMAL_MODE);;
	switch (err) {
	case 0:
		/* Modem library was initialized successfully. */
		break;
	case MODEM_DFU_RESULT_OK:
		printk("Modem firmware update successful!\n");
		printk("Modem will run the new firmware after reboot\n");
		sys_reboot(SYS_REBOOT_WARM);
		return;
	case MODEM_DFU_RESULT_UUID_ERROR:
	case MODEM_DFU_RESULT_AUTH_ERROR:
		printk("Modem firmware update failed!\n");
		printk("Modem will run non-updated firmware on reboot.\n");
		sys_reboot(SYS_REBOOT_WARM);
		return;
	case MODEM_DFU_RESULT_HARDWARE_ERROR:
	case MODEM_DFU_RESULT_INTERNAL_ERROR:
		printk("Modem firmware update failed!\n");
		printk("Fatal error.\n");
		sys_reboot(SYS_REBOOT_WARM);
		return;
	default:
		/* Modem library initialization failed. */
		printk("Could not initialize modemlib.\n");
		printk("Fatal error.\n");
		return;
	}
#else
	/* Wait until the LwM2M carrier library has initialized the modem library. */
	k_sem_take(&mosh_carrier_lib_initialized, K_FOREVER);
#endif
	lte_lc_init();
#if defined(CONFIG_MOSH_PPP)
	ppp_ctrl_init();
#endif
#if defined(CONFIG_MOSH_WORKER_THREADS)
	th_ctrl_init();
#endif
#if defined(CONFIG_MOSH_FOTA)
	err = fota_init();
	if (err) {
		printk("Could not initialize FOTA: %d\n", err);
	}
#endif

#if defined(CONFIG_MOSH_LOCATION)
	/* Location library should be initialized before LTE normal mode */
	location_ctrl_init();
#endif
#if defined(CONFIG_LTE_LINK_CONTROL) && defined(CONFIG_MOSH_LINK)
	link_init();
#endif

#if defined(CONFIG_MODEM_INFO)
	err = modem_info_init();
	if (err) {
		printk("Modem info could not be established: %d\n", err);
		return;
	}
#endif

#if defined(CONFIG_DK_LIBRARY)
	err = dk_buttons_init(button_handler);
	if (err) {
		printk("Failed to initialize DK buttons library, error: %d\n", err);
	}
	err = dk_leds_init();
	if (err) {
		printk("Cannot initialize LEDs (err: %d)\n", err);
	}
#endif
	/* Application started successfully, mark image as OK to prevent
	 * revert at next reboot.
	 */
#if defined(CONFIG_BOOTLOADER_MCUBOOT)
	boot_write_img_confirmed();
#endif
	k_poll_signal_init(&mosh_signal);

#if defined(CONFIG_SHELL_BACKEND_SERIAL)
	/* Resize terminal width and height of the shell to have proper command editing. */
	shell_execute_cmd(mosh_shell, "resize");
#endif

#if defined(CONFIG_MOSH_STARTUP_CMDS)
	startup_cmd_ctrl_init();
#endif

#if defined(CONFIG_MOSH_AT_CMD_MODE)
	at_cmd_mode_sett_init();
	if (at_cmd_mode_sett_is_autostart_enabled()) {
		/* Start directly in AT cmd mode */
		at_cmd_mode_start(mosh_shell);
	}
#endif
}
```
