## CMakeLists.txt
```
#
# Copyright (c) 2026 Nordic Semiconductor ASA
#
# SPDX-License-Identifier: LicenseRef-Nordic-5-Clause
#

cmake_minimum_required(VERSION 3.20.0)

find_package(Zephyr REQUIRED HINTS $ENV{ZEPHYR_BASE})
project(tcp_edrx_mt)

# NORDIC SDK APP START
target_sources(app PRIVATE src/main.c)
# NORDIC SDK APP END

zephyr_include_directories(src)
```

## Kconfig
```
#
# Copyright (c) 2026 Nordic Semiconductor ASA
#
# SPDX-License-Identifier: LicenseRef-Nordic-5-Clause
#

menu "TCP eDRX MT-data test"

config TCP_TEST_SERVER_ADDRESS
	string "TCP server IPv4 address"
	default "100.30.211.218"
	help
	  Public IPv4 address of the test server (server.py).

config TCP_TEST_SERVER_PORT
	int "TCP server port"
	default 7777

config TCP_TEST_KEEPALIVE_SECONDS
	int "Uplink keepalive interval in seconds (0 = listen only)"
	default 0
	help
	  If greater than 0, send a small uplink packet at this interval to keep
	  the TCP/NAT binding alive and to mirror the field device's periodic
	  'state' messages (which generate the MO connections that sometimes
	  catch the delayed downlink). Set to 0 to only listen for downlink,
	  which is the purest observation of the MT-delivery delay.

config TCP_TEST_RECV_BUF_SIZE
	int "Receive buffer size in bytes"
	default 512

endmenu

module = TCP_TEST
module-str = TCP eDRX MT-data test
source "$(ZEPHYR_BASE)/subsys/logging/Kconfig.template.log_config"

menu "Zephyr Kernel"
source "Kconfig.zephyr"
endmenu
```

## prj.conf
```kconfig
#
# Copyright (c) 2026 Nordic Semiconductor ASA
#
# SPDX-License-Identifier: LicenseRef-Nordic-5-Clause
#

# TF-M (required for the *_ns board target)
CONFIG_TFM_PROFILE_TYPE_MINIMAL=y

# General
CONFIG_NCS_SAMPLES_DEFAULTS=y

# Logging — full deferred mode (timestamps + colors).
# NCS_SAMPLES_DEFAULTS implies LOG_DEFAULT_MINIMAL (no prompt), which only defaults the
# LOG_MODE choice to minimal; explicitly select deferred to override it.
CONFIG_LOG=y
CONFIG_LOG_MODE_DEFERRED=y

# Networking / sockets offloaded to the modem
CONFIG_NETWORKING=y
CONFIG_NET_NATIVE=n
CONFIG_NET_SOCKETS=y
CONFIG_NET_SOCKETS_OFFLOAD=y
CONFIG_POSIX_API=y

# Modem library + LTE link control
CONFIG_NRF_MODEM_LIB=y
CONFIG_LTE_LINK_CONTROL=y
CONFIG_LTE_LC_EDRX_MODULE=y

# Force LTE-M (matches the field config AT%XSYSTEMMODE=1,0,1,0)
CONFIG_LTE_NETWORK_MODE_LTE_M=y

# eDRX: request a 61.44 s cycle with a 2.56 s PTW for LTE-M (matches the field setup).
#   eDRX value "0100" = 61.44 s, PTW value "0001" = 2.56 s  (3GPP TS 24.008 WB-S1 tables)
CONFIG_LTE_EDRX_REQ=y
CONFIG_LTE_EDRX_REQ_VALUE_LTE_M="0100"
CONFIG_LTE_PTW_VALUE_LTE_M="0001"

# PSM is intentionally NOT requested: we want the UE reachable via paging in eDRX
# between server pushes. (PSM would make it unreachable until the next TAU.)

# Modem trace — capture with the Cellular Monitor app over the DK trace UART.
CONFIG_NRF_MODEM_LIB_TRACE=y

# Heap and stacks
CONFIG_HEAP_MEM_POOL_SIZE=2048
CONFIG_MAIN_STACK_SIZE=4096
CONFIG_SYSTEM_WORKQUEUE_STACK_SIZE=2048
```

## src/main.c
```c
/*
 * Copyright (c) 2026 Nordic Semiconductor ASA
 *
 * SPDX-License-Identifier: LicenseRef-Nordic-5-Clause
 */

#include <zephyr/kernel.h>
#include <zephyr/logging/log.h>
#include <string.h>
#include <errno.h>
#include <unistd.h>
#include <sys/socket.h>
#include <arpa/inet.h>
#include <modem/lte_lc.h>
#include <modem/nrf_modem_lib.h>

LOG_MODULE_REGISTER(tcp_edrx_mt, CONFIG_TCP_TEST_LOG_LEVEL);

static int sock = -1;
static struct sockaddr_in server_addr;

K_SEM_DEFINE(lte_connected_sem, 0, 1);

#if CONFIG_TCP_TEST_KEEPALIVE_SECONDS > 0
static struct k_work_delayable keepalive_work;
#endif

static void lte_handler(const struct lte_lc_evt *const evt)
{
	switch (evt->type) {
	case LTE_LC_EVT_NW_REG_STATUS:
		if ((evt->nw_reg_status != LTE_LC_NW_REG_REGISTERED_HOME) &&
		    (evt->nw_reg_status != LTE_LC_NW_REG_REGISTERED_ROAMING)) {
			break;
		}

		LOG_INF("Network registration: %s",
			evt->nw_reg_status == LTE_LC_NW_REG_REGISTERED_HOME ?
			"home" : "roaming");

		k_sem_give(&lte_connected_sem);

		break;
	case LTE_LC_EVT_EDRX_UPDATE:
		/* Printed as integer milliseconds to avoid pulling in float printf. */
		LOG_INF("eDRX granted: eDRX %d ms, PTW %d ms",
			(int)(evt->edrx_cfg.edrx * 1000.0f),
			(int)(evt->edrx_cfg.ptw * 1000.0f));

		break;
	case LTE_LC_EVT_RRC_UPDATE:
		/* Maps to +CSCON: connected/idle — useful to align with paging. */
		LOG_INF("RRC mode: %s",
			evt->rrc_mode == LTE_LC_RRC_MODE_CONNECTED ?
			"connected" : "idle");

		break;
	case LTE_LC_EVT_CELL_UPDATE:
		LOG_INF("Cell update: Cell ID %d, TAC %d", evt->cell.id, evt->cell.tac);

		break;
	default:
		break;
	}
}

static int server_connect(void)
{
	int err;

	sock = socket(AF_INET, SOCK_STREAM, IPPROTO_TCP);
	if (sock < 0) {
		LOG_ERR("Failed to create TCP socket, errno %d", errno);

		return -errno;
	}

	err = connect(sock, (struct sockaddr *)&server_addr, sizeof(server_addr));
	if (err) {
		LOG_ERR("Failed to connect, errno %d", errno);
		close(sock);

		sock = -1;

		return -errno;
	}

	LOG_INF("TCP connected to %s:%d", CONFIG_TCP_TEST_SERVER_ADDRESS,
		CONFIG_TCP_TEST_SERVER_PORT);

	return 0;
}

#if CONFIG_TCP_TEST_KEEPALIVE_SECONDS > 0
static void keepalive_fn(struct k_work *work)
{
	if (sock >= 0) {
		const char ka[] = "ka";
		int err = send(sock, ka, strlen(ka), 0);

		LOG_INF("TX keepalive (%d)", err);
	}

	k_work_schedule(&keepalive_work, K_SECONDS(CONFIG_TCP_TEST_KEEPALIVE_SECONDS));
}
#endif

int main(void)
{
	int err;
	static uint8_t buf[CONFIG_TCP_TEST_RECV_BUF_SIZE];

	LOG_INF("TCP eDRX MT-data test started");

	err = nrf_modem_lib_init();
	if (err) {
		LOG_ERR("Failed to initialize modem library, error: %d", err);

		return -1;
	}

	LOG_INF("Connecting to LTE-M (eDRX 61.44 s / PTW 2.56 s requested)...");

	err = lte_lc_connect_async(lte_handler);
	if (err) {
		LOG_ERR("Failed to connect to LTE network, error: %d", err);

		return -1;
	}

	k_sem_take(&lte_connected_sem, K_FOREVER);

	server_addr.sin_family = AF_INET;
	server_addr.sin_port = htons(CONFIG_TCP_TEST_SERVER_PORT);

	inet_pton(AF_INET, CONFIG_TCP_TEST_SERVER_ADDRESS, &server_addr.sin_addr);

#if CONFIG_TCP_TEST_KEEPALIVE_SECONDS > 0
	k_work_init_delayable(&keepalive_work, keepalive_fn);
#endif

	/* (Re)connect and receive forever. recv() blocks, so the modem is free to
	 * enter eDRX sleep between downlink packets; it returns when data arrives.
	 */
	while (1) {
		if (sock < 0) {
			if (server_connect() != 0) {
				LOG_WRN("Reconnect in 10 s");
				k_sleep(K_SECONDS(10));

				continue;
			}
#if CONFIG_TCP_TEST_KEEPALIVE_SECONDS > 0
			k_work_schedule(&keepalive_work,
					K_SECONDS(CONFIG_TCP_TEST_KEEPALIVE_SECONDS));
#endif
		}

		int len = recv(sock, buf, sizeof(buf) - 1, 0);

		if (len > 0) {
			buf[len] = '\0';

			LOG_INF("RX %d bytes: %s", len, (char *)buf);

			/* Confirm receipt by echoing the payload back. The server waits
			 * for this uplink before sending the next package, and the
			 * send->confirm round trip is what reveals the MT-delivery delay.
			 */
			if (send(sock, buf, len, 0) < 0) {
				LOG_ERR("Failed to send confirmation, errno %d", errno);
			}
		} else if (len == 0) {
			LOG_WRN("Peer closed connection; reconnecting");
			close(sock);

			sock = -1;
		} else {
			LOG_ERR("recv error, errno %d; reconnecting", errno);
			close(sock);

			sock = -1;

			k_sleep(K_SECONDS(2));
		}
	}
}
```
