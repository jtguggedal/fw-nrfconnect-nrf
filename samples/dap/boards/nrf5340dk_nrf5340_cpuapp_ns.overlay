/*
 * Copyright (c) 2023 Nordic Semiconductor ASA
 *
 * SPDX-License-Identifier: Apache-2.0
 */

 
 / {
	dp0 {
		compatible = "zephyr,swdp-gpio";
		status = "okay";
		clk-gpios = <&gpio0 19 GPIO_ACTIVE_HIGH>;
		dio-gpios = <&gpio0 20 GPIO_ACTIVE_HIGH>;
		noe-gpios = <&gpio0 21 GPIO_ACTIVE_HIGH>;
		reset-gpios = <&gpio0 22 GPIO_ACTIVE_HIGH>;
		port-write-cycles = <2>;
	};
};
