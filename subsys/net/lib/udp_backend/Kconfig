## subsys/net/lib/udp_backend/Kconfig
```kconfig
#
# Copyright (c) 2019 Nordic Semiconductor
#
# SPDX-License-Identifier: LicenseRef-BSD-5-Clause-Nordic
#

menuconfig UDP_BACKEND
	bool "UDP backend library"

if UDP_BACKEND

config UDP_BACKEND_STATIC_IPV4_ADDR
	string "Static IPv4 address"
	default "18.196.48.166"

config UDP_BACKEND_PORT
	int "UDP backend server port"
	default 8888

config UDP_BACKEND_RX_TX_BUFFER_LEN
	int "Buffer sizes for the UDP backend."
	default 256
	help
	  Specifies maximum message size can be transmitted/received

module=UDP_BACKEND
module-dep=LOG
module-str=UDP backend
source "${ZEPHYR_BASE}/subsys/logging/Kconfig.template.log_config"

endif # UDP_BACKEND
```

## west.yml
```yaml
# The west manifest file for the nRF Connect SDK (NCS).
#
# The per-installation west configuration file specifies the location of this
# manifest file. The "path" option in the [manifest] section of .west/config
# defines the folder that contains west.yml. The path is relative to the folder
# that contains .west.
#
# You can create your own manifest files and put them in any
# repository you want, to create your own custom NCS installation.
# For example, you could create a manifest file in your own
# out-of-tree application directory, which would pull the nrf repository
# in as an ordinary project.
#
# You can pass your manifest repositories to west init when creating a
# new NCS installation. See the west documentation for more
# information.

west:
  url: https://github.com/zephyrproject-rtos/west
  revision: v0.5.8

manifest:
  defaults:
    remote: ncs

  remotes:
      # nRF Connect SDK base URL.
    - name: ncs
      url-base: https://github.com/NordicPlayground
    - name: jtguggedal
      url-base: https://github.com/jtguggedal
    - name: joakimtoe
      url-base: https://github.com/joakimtoe

  # The list of external projects for the nRF Connect SDK.
  #
  projects:
    - name: fw-nrfconnect-zephyr
      path: zephyr
      west-commands: scripts/west-commands.yml
      revision: 490c6e16d986ccc38c0a54a8c5178a48cc8219f7
      remote: jtguggedal
    - name: fw-nrfconnect-mcuboot
      path: mcuboot
      revision: 45b99f43c7ed3469c1a2df56dbb135f8ebfa50c6
      remote: joakimtoe
    - name: nrfxlib
      path: nrfxlib
      revision: eea93e6bbb49381c077231357d52cd321fad4f9e
      remote: jtguggedal

  self:
    path: nrf
```
