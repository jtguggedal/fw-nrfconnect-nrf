## applications/asset_tracker_v2/src/cloud/cloud_codec/Kconfig
```kconfig
#
# Copyright (c) 2021 Nordic Semiconductor
#
# SPDX-License-Identifier: LicenseRef-BSD-5-Clause-Nordic
#

config GPS_BUFFER_MAX
	int "GPS data ringbuffer entries"
	default 8

config SENSOR_BUFFER_MAX
	int "Sensor data ringbuffer entries"
	default 8

config MODEM_DYNAMIC_BUFFER_MAX
	int "Dynamic modem data ringbuffer entries"
	default 1

config MODEM_STATIC_BUFFER_MAX
	int "Static modem data ringbuffer entries"
	default 1

config UI_BUFFER_MAX
	int "UI data ringbuffer entries"
	default 1

config ACCEL_BUFFER_MAX
	int "Accelerometer data ringbuffer entries"
	default 1

config BATTERY_BUFFER_MAX
	int "Battery data ringbuffer entries"
	default 1

module = CLOUD_CODEC
module-str = Cloud codec
source "subsys/logging/Kconfig.template.log_config"
```

## applications/asset_tracker_v2/src/modules/Kconfig
```kconfig
#
# Copyright (c) 2021 Nordic Semiconductor
#
# SPDX-License-Identifier: LicenseRef-Nordic-5-Clause
#

module = MODULE_COMMON
module-str = Common module API
source "subsys/logging/Kconfig.template.log_config"

rsource "app/Kconfig"
rsource "cloud/Kconfig"
rsource "data/Kconfig"
rsource "debug/Kconfig"
rsource "location/Kconfig"
rsource "led/Kconfig"
rsource "modem/Kconfig"
rsource "sensor/Kconfig"
rsource "ui/Kconfig"
rsource "util/Kconfig"
```

## boards/arm/thingy91x_nrf5340/thingy91x_nrf5340_cpunet_defconfig
```kconfig
# SPDX-License-Identifier: Apache-2.0

CONFIG_SOC_SERIES_NRF53X=y
CONFIG_SOC_NRF5340_CPUNET_QKAA=y
CONFIG_BOARD_THINGY91X_NRF5340_CPUNET=y

# Enable MPU
CONFIG_ARM_MPU=y

# Enable hardware stack protection
CONFIG_HW_STACK_PROTECTION=y

# enable GPIO
CONFIG_GPIO=y

# Enable uart driver
CONFIG_SERIAL=y

# enable console
CONFIG_CONSOLE=y
CONFIG_UART_CONSOLE=y

CONFIG_PINCTRL=y

# this can be omitted if the app core uses custom firmware
CONFIG_CLOCK_CONTROL_NRF_K32SRC_RC=y
```

## boards/arm/thingy91x_nrf9161/Kconfig.board
```kconfig
# Thingy:91 nRF9161 board configuration
#
# Copyright (c) 2019 Nordic Semiconductor ASA
#
# SPDX-License-Identifier: LicenseRef-Nordic-5-Clause

if SOC_NRF9161_SICA

config BOARD_THINGY91X_NRF9161
	bool "nRF9161 THINGY91X"

config BOARD_THINGY91X_NRF9161_NS
	bool "nRF9161 THINGY91X non-secure"

endif # SOC_NRF9161_SICA
```

## boards/arm/thingy91x_nrf9161/Kconfig.defconfig
```kconfig
# Thingy:91 nRF9161 board configuration
#
# Copyright (c) 2018 Nordic Semiconductor ASA
#
# SPDX-License-Identifier: LicenseRef-Nordic-5-Clause

if BOARD_THINGY91X_NRF9161 || BOARD_THINGY91X_NRF9161_NS

config BOARD
	default "thingy91x_nrf9161"

# By default, if we build for a Non-Secure version of the board,
# enable building with TF-M as the Secure Execution Environment.
config BUILD_WITH_TFM
	default y if BOARD_THINGY91X_NRF9161_NS

if BUILD_WITH_TFM

# By default, if we build with TF-M, instruct build system to
# flash the combined TF-M (Secure) & Zephyr (Non Secure) image
config TFM_FLASH_MERGED_BINARY
	bool
	default y

endif # BUILD_WITH_TFM

# For the secure version of the board the firmware is linked at the beginning
# of the flash, or into the code-partition defined in DT if it is intended to
# be loaded by MCUboot. If the secure firmware is to be combined with a non-
# secure image (TRUSTED_EXECUTION_SECURE=y), the secure FW image shall always
# be restricted to the size of its code partition.
# For the non-secure version of the board, the firmware
# must be linked into the code-partition (non-secure) defined in DT, regardless.
# Apply this configuration below by setting the Kconfig symbols used by
# the linker according to the information extracted from DT partitions.

if BOARD_THINGY91X_NRF9161 && TRUSTED_EXECUTION_SECURE

config FLASH_LOAD_SIZE
	default $(dt_chosen_reg_size_hex,$(DT_CHOSEN_Z_CODE_PARTITION))

endif # BOARD_THINGY91X_NRF9161 && TRUSTED_EXECUTION_SECURE

if BOARD_THINGY91X_NRF9161_NS

config FLASH_LOAD_OFFSET
	default $(dt_chosen_reg_addr_hex,$(DT_CHOSEN_Z_CODE_PARTITION))

config FLASH_LOAD_SIZE
	default $(dt_chosen_reg_size_hex,$(DT_CHOSEN_Z_CODE_PARTITION))

endif # BOARD_THINGY91X_NRF9161_NS

config BT_HCI_VS
	default y if BT

config HW_STACK_PROTECTION
	default ARCH_HAS_STACK_PROTECTION

# check if we are building for any bootloader
if (!IS_SECURE_BOOTLOADER && !MCUBOOT)

# Please do not use these keys for own custom boards!
# These are meant as examples and therefore public.
# The documentation of the nRF Secure Immutable Bootloader and MCUBoot detail on how
# to set up your own keys.

config SB_SIGNING_KEY_FILE
	default "$(ZEPHYR_NRF_MODULE_DIR)/boards/arm/thingy91x_nrf9161/nsib_signing_key.pem"

config I2C
	default y

config MODEM_ANTENNA
	depends on NRF_MODEM_LIB
	default y

if MODEM_ANTENNA

config MODEM_ANTENNA_AT_MIPIRFFEDEV
	default "AT%XMIPIRFFEDEV=1,4,71,198,248"
config MODEM_ANTENNA_AT_MIPIRFFECTRL_INIT
	default "AT%XMIPIRFFECTRL=1,0,1,28,248"
config MODEM_ANTENNA_AT_MIPIRFFECTRL_ON
	default "AT%XMIPIRFFECTRL=1,1,1,28,56,13,0,0,8,8,715,4,4,770,12,12,829,11,11,863,130,130,892,1,1,939,129,129,978,26,26,1042,8,8,1118,4,4,1270,12,12,1386,14,14,1523,130,130,2200"
config MODEM_ANTENNA_AT_MIPIRFFECTRL_OFF
	default "AT%XMIPIRFFECTRL=1,2,1,28,184"
config MODEM_ANTENNA_AT_MIPIRFFECTRL_PWROFF
	default "AT%XMIPIRFFECTRL=1,3,1,28,184"

endif # MODEM_ANTENNA

endif # (!IS_SECURE_BOOTLOADER && !MCUBOOT)
endif # BOARD_THINGY91X_NRF9161 || BOARD_THINGY91X_NRF9161_NS
```

## boards/arm/thingy91x_nrf9161/thingy91x_nrf9161_defconfig
```kconfig
CONFIG_SOC_SERIES_NRF91X=y
CONFIG_SOC_NRF9161_SICA=y
CONFIG_BOARD_THINGY91X_NRF9161=y

# Enable MPU
CONFIG_ARM_MPU=y

# Enable TrustZone-M
CONFIG_ARM_TRUSTZONE_M=y

# Enable PINCTRL
CONFIG_PINCTRL=y

# Enable GPIO
CONFIG_GPIO=y

# Enable UARTE
CONFIG_SERIAL=y

# Enable console
CONFIG_CONSOLE=y
CONFIG_UART_CONSOLE=y

# Disable entropy driver, as it's not yet implemented for nRF9161
CONFIG_ENTROPY_NRF5_RNG=n
```

## boards/arm/thingy91x_nrf9161/thingy91x_nrf9161_ns_defconfig
```kconfig
CONFIG_SOC_SERIES_NRF91X=y
CONFIG_SOC_NRF9161_SICA=y
CONFIG_BOARD_THINGY91X_NRF9161_NS=y

# Enable MPU
CONFIG_ARM_MPU=y

# Enable TrustZone-M
CONFIG_ARM_TRUSTZONE_M=y

# This Board implies building Non-Secure firmware
CONFIG_TRUSTED_EXECUTION_NONSECURE=y

# Enable PINCTRL
CONFIG_PINCTRL=y

# Enable GPIO
CONFIG_GPIO=y

# Enable UARTE
CONFIG_SERIAL=y

# Enable console
CONFIG_CONSOLE=y
CONFIG_UART_CONSOLE=y

# Enable I2C
CONFIG_I2C=y

# Enable SPI
CONFIG_SPI=y

# Enable Flash
CONFIG_FLASH=y
CONFIG_SPI_NOR=y
CONFIG_SPI_NOR_SFDP_DEVICETREE=y
CONFIG_SPI_NOR_FLASH_LAYOUT_PAGE_SIZE=4096

# Disable entropy driver, as it's not yet implemented for nRF9161
CONFIG_ENTROPY_NRF5_RNG=n

CONFIG_BOOTLOADER_MCUBOOT=y
```

## drivers/dp/Kconfig
```kconfig
# Copyright (c) 2019 Phytec Messtechnik GmbH
#
# SPDX-License-Identifier: Apache-2.0

menuconfig DP_DRIVER
	bool "Debug Port interface driver [EXPERIMENTAL]"
	select EXPERIMENTAL
	help
	  Enable Debug Port interface driver

if DP_DRIVER

module = DP_DRIVER
module-str = dp drv
source "subsys/logging/Kconfig.template.log_config"

config DP_DRIVER_INIT_PRIO
	int "Debug Port driver initialization priority"
	default 80
	help
	  Set the initialization priority number.

config SWDP_BITBANG_DRIVER
	bool "Serial Wire Debug Port bit-bang driver"
	default y
	depends on DT_HAS_ZEPHYR_SWDP_GPIO_ENABLED
	depends on GPIO
	help
	  Serial Wire Debug Port bit-bang driver.

if SWDP_BITBANG_DRIVER

config SWDP_BITBANG_DRIVER_SEPARATE_IN_OUT
	bool "SWDIO is connected through transceiver"
	default n
	help
	  Instead of DIO, DIN, DOUT and DNOE should be defined.

endif # SWDP_BITBANG_DRIVER

endif # DP_DRIVER
```

## drivers/i2c_virtual_eeprom/Kconfig
```kconfig
#
#  Copyright (c) 2023 Nordic Semiconductor ASA
#
#  SPDX-License-Identifier: LicenseRef-Nordic-5-Clause
#

menuconfig I2C_VIRTUAL_EEPROM_DRIVER
	bool "I2C virtual EEPROM"
	depends on I2C
	depends on DT_HAS_NORDIC_NRF_TWIS_ENABLED
	depends on DT_HAS_NORDIC_I2C_VIRTUAL_EEPROM_ENABLED
	select NRFX_TWIS0 if HAS_HW_NRF_TWIS0
	select NRFX_TWIS1 if HAS_HW_NRF_TWIS1
	select NRFX_TWIS2 if HAS_HW_NRF_TWIS2
	help
	  Enable I2C virtual EEPROM slave driver.

if I2C_VIRTUAL_EEPROM_DRIVER

module = I2C_VIRTUAL_EEPROM_DRIVER
module-str = i2c virtual eeprom
source "subsys/logging/Kconfig.template.log_config"

endif # I2C_EEPROM_SLAVE
```

## dts/bindings/misc/nordic,i2c-virtual-eeprom.yaml
```yaml
# Copyright (c) 2023 Nordic Semiconductor ASA
# SPDX-License-Identifier: LicenseRef-Nordic-5-Clause

description: >
    This is a i2c slave device that acts as a virtual eeprom for a bus master.
 
compatible: "nordic,i2c-virtual-eeprom"

include: base.yaml

properties:
    i2c-bus-idx:
      type: int
      required: true
      description: i2c bus index

    sda-gpios:
      type: phandle-array
      required: true
      description: GPIO pin used for SDA

    scl-gpios:
      type: phandle-array
      required: true
      description: GPIO pin used for SCL

    address:
      type: int
      required: true
      description: Address of the i2c device on the bus

    size:
      type: int
      description: Size of the virtual eeprom memory
      default: 1024
```

## lib/conn_bridge_control/Kconfig
```kconfig
#
#  Copyright (c) 2023 Nordic Semiconductor ASA
#
#  SPDX-License-Identifier: LicenseRef-Nordic-5-Clause
#

config CONN_BRIDGE_CONTROL_HOST
	bool "Connectivity Bridge Control Host Library"
	depends on I2C_VIRTUAL_EEPROM_DRIVER
	help
	  Enable the connectivity bridge control host library.

config CONN_BRIDGE_CONTROL_CLIENT
	bool "Connectivity Bridge Control Client Library"
	depends on EEPROM_AT24
	help
	  Enable the connectivity bridge control client library.
```

## lib/memfault/Kconfig
```kconfig
#
# Copyright (c) 2021 Nordic Semiconductor ASA
#
# SPDX-License-Identifier: LicenseRef-Nordic-5-Clause
#

if MEMFAULT

config MEMFAULT_API_KEY
        string "Memfault API key"

config MEMFAULT_DEVICE_ID
        string "Memfault device ID"

config MEMFAULT_DEVICE_ID_USE_IMEI
        bool "Use IMEI as Memfault device ID"
        depends on AT_CMD
        default y if BOARD_NRF9160DK_NRF9160NS || BOARD_THINGY91_NRF9160NS

config MEMFAULT_INIT_PRIORITY
        int "memfault initialization priority"
        range AT_CMD_INIT_PRIORITY 99 if MEMFAULT_DEVICE_ID_USE_IMEI
        default 90
        help
          If IMEI is used as device ID, the initialization priority must be
          greater than that of the AT command module.

endif # MEMFAULT
```

## lib/multicell_location/Kconfig
```kconfig
#
# Copyright (c) 2021 Nordic Semiconductor ASA
#
# SPDX-License-Identifier: LicenseRef-Nordic-5-Clause
#

menuconfig MULTICELL_LOCATION
	bool "Multicell Location"
	depends on NRF_MODEM_LIB
	depends on LTE_LINK_CONTROL
	select MODEM_KEY_MGMT
	select CJSON_LIB

if MULTICELL_LOCATION

choice MULTICELL_LOCATION_SERVICE
	prompt "Location service"
	default MULTICELL_LOCATION_SERVICE_NONE

config MULTICELL_LOCATION_SERVICE_NONE
	bool "No location service"

config MULTICELL_LOCATION_SERVICE_HERE
	bool "HERE location service"

config MULTICELL_LOCATION_SERVICE_SKYHOOK
	bool "Skyhook location service"

config MULTICELL_LOCATION_SERVICE_POLTE
	bool "Polte location service"

endchoice

if MULTICELL_LOCATION_SERVICE_HERE
choice MULTICELL_LOCATION_SERVICE_HERE_VERSION
	prompt "HERE Positioning API version"
	default MULTICELL_LOCATION_HERE_V2

config MULTICELL_LOCATION_HERE_V1
	bool "HERE API v1"

config MULTICELL_LOCATION_HERE_V2
	bool "HERE API v2"

endchoice

choice MULTICELL_LOCATION_HERE_AUTH_METHOD
	prompt "HERE authentication method"
	default MULTICELL_LOCATION_HERE_USE_API_KEY

config MULTICELL_LOCATION_HERE_USE_API_KEY
	bool "Use API key"

config MULTICELL_LOCATION_HERE_USE_APP_CODE_ID
	bool "Use app code and ID"

endchoice

config MULTICELL_LOCATION_HERE_HOSTNAME
	string "HERE hostname"

config MULTICELL_LOCATION_HERE_API_KEY
	string "HERE API key"
	depends on MULTICELL_LOCATION_HERE_USE_API_KEY

if MULTICELL_LOCATION_HERE_USE_APP_CODE_ID
config MULTICELL_LOCATION_HERE_APP_CODE
	string "HERE APP code"

config MULTICELL_LOCATION_HERE_APP_ID
	string "HERE APP ID"

endif # MULTICELL_LOCATION_HERE_USE_APP_CODE_ID
endif # MULTICELL_LOCATION_SERVICE_HERE

if MULTICELL_LOCATION_SERVICE_SKYHOOK

config MULTICELL_LOCATION_SKYHOOK_API_KEY
	string "Skyhook API key"

config MULTICELL_LOCATION_SKYHOOK_HOSTNAME
	string "Skyhook hostname"

endif # MULTICELL_LOCATION_SERVICE_SKYHOOK

if MULTICELL_LOCATION_SERVICE_POLTE

config MULTICELL_LOCATION_POLTE_CUSTOMER_ID
	string "Polte customer ID"

config MULTICELL_LOCATION_POLTE_API_TOKEN
	string "Polte API token"

endif # MULTICELL_LOCATION_SERVICE_POLTE

config MULTICELL_LOCATION_HTTPS_PORT
	int "HTTPS port number"
	default 443

config MULTICELL_LOCATION_HOSTNAME
	string "Server hostname"
	default "pos.api.here.com" if MULTICELL_LOCATION_HERE_V1
	default "positioning.hereapi.com" if MULTICELL_LOCATION_HERE_V2
	default "global.skyhookwireless.com" if MULTICELL_LOCATION_SERVICE_SKYHOOK
	default "polte.io" if MULTICELL_LOCATION_SERVICE_POLTE

config MULTICELL_LOCATION_TLS_SEC_TAG
	int "Security tag for TLS certificates"
	default 175 if MULTICELL_LOCATION_SERVICE_HERE
	default 176 if MULTICELL_LOCATION_SERVICE_SKYHOOK
	default 177 if MULTICELL_LOCATION_SERVICE_POLTE
	default -1
	help
	  Security tag where the required TLS certificates for the selected
	  service will be stored.

config MULTICELL_LOCATION_SEND_BUF_SIZE
	int "Send buffer size"
	default 2048 if( MULTICELL_LOCATION_SERVICE_SKYHOOK || MULTICELL_LOCATION_SERVICE_POLTE)
	default 1024
	help
	  Size of the buffer used to store the generated HTTP request that's sent
	  to the location service.

config MULTICELL_LOCATION_RECV_BUF_SIZE
	int "Receive buffer size"
	default 1536 if MULTICELL_LOCATION_SERVICE_POLTE
	default 512
	help
	  Size of the buffer used to store the response from the location
	  service.


module = MULTICELL_LOCATION
module-str = Multicell location
source "${ZEPHYR_BASE}/subsys/logging/Kconfig.template.log_config"

endif # MULTICELL_LOCATION
```
