## modules/memfault/Kconfig
```kconfig
#
# Copyright (c) 2021 Nordic Semiconductor ASA
#
# SPDX-License-Identifier: LicenseRef-Nordic-5-Clause
#

if MEMFAULT

config MEMFAULT_USE_EXTRA_DEFS_FILE
        bool
        select MEMFAULT_METRICS_EXTRA_DEFS_FILE
        default y

config MEMFAULT_API_KEY
        string "Memfault API key"

config MEMFAULT_DEVICE_ID
        string "Memfault device ID"

config MEMFAULT_DEVICE_SERIAL_USE_IMEI
        bool "Use IMEI as Memfault device serial"
        depends on AT_CMD
        default y if BOARD_NRF9160DK_NRF9160NS || BOARD_THINGY91_NRF9160NS

config MEMFAULT_HW_VERSION
        string "Hardware version"
        default CONFIG_BOARD

config MEMFAULT_FW_TYPE
        string "Firmware type"
        default "nrf91-fw" if BOARD_NRF9160DK_NRF9160 || BOARD_THINGY91_NRF9160
        default "nrf91ns-fw" if BOARD_NRF9160DK_NRF9160NS || BOARD_THINGY91_NRF9160NS
        help
          Firmware type running on the board.

choice
	prompt "Firmware version generation method"
        default MEMFAULT_FW_VERSION_AUTO

config MEMFAULT_FW_VERSION_STATIC
        bool "Static firmware version"
        help
          Use statically configured firmware version, as opposed to an
          dynamically generated one.

config MEMFAULT_FW_VERSION_AUTO
        bool "Dynamic firmware version"
        help
          Use dyanimically generated firmware version. The version is
          re-generated on every compiler run.
endchoice

config MEMFAULT_FW_VERSION_PREFIX
        string "Firmware version prefix"
        depends on MEMFAULT_FW_VERSION_AUTO
        default "0.0.1+"
        help
          Prefix to use in front of automatically generated build version string.
          If the build version string is "a1b2c3d", the full firmware version
          will become "<prefix>a1b2c3d".

config MEMFAULT_INIT_PRIORITY
        int "memfault initialization priority"
        range AT_CMD_INIT_PRIORITY 99 if MEMFAULT_DEVICE_SERIAL_USE_IMEI
        default 90
        help
          If IMEI is used as device ID, the initialization priority must be
          greater than that of the AT command module.

config MEMFAULT_PROVISION_CERTIFICATES
        bool "Provision certificates on initalization"
        default y
        help
          Provision required TLS root certificates for connecting to Memfault's
          endpoints. If this option is disabled, the user is responsible for
          calling the appropriate Memfault APIs for provisioning the
          certificates before attempting to connect to Memfault servers.

config MEMFAULT_LTE_METRICS
        bool "Capture LTE metrics"
        select LTE_LC_TRACE
        depends on LTE_LINK_CONTROL

module = MEMFAULT_INTEGRATION
module-dep = LOG
module-str = Memfault integration library
source "${ZEPHYR_BASE}/subsys/logging/Kconfig.template.log_config"


endif # MEMFAULT
```

## samples/net/aws_iot/boards/nrf54l15dk_nrf54l15_cpuapp.conf
```kconfig
#
# Copyright (c) 2024 Nordic Semiconductor ASA
#
# SPDX-License-Identifier: LicenseRef-Nordic-5-Clause
#

# Wi-Fi
CONFIG_WIFI=y
CONFIG_WIFI_NRF70=y

# WPA supplicant
CONFIG_WIFI_NM_WPA_SUPPLICANT=y
CONFIG_WIFI_NM_WPA_SUPPLICANT_LOG_LEVEL_INF=y

# Networking
CONFIG_NET_L2_ETHERNET=y
CONFIG_NETWORKING=y
CONFIG_NET_SOCKETS=y
CONFIG_NET_IPV6=y
CONFIG_NET_IPV4=y
CONFIG_NET_UDP=y
CONFIG_NET_TCP=y
CONFIG_NET_DHCPV4=y
CONFIG_DNS_RESOLVER=y
CONFIG_DNS_RESOLVER_AI_MAX_ENTRIES=4

# NET sockets
CONFIG_NET_UDP=y
CONFIG_NET_TCP=y
CONFIG_NET_MAX_CONN=6
CONFIG_NET_MAX_CONTEXTS=5
CONFIG_NET_SOCKETS_POLL_MAX=8
CONFIG_NET_SOCKETS_OFFLOAD=n
CONFIG_NET_DHCPV4=y
CONFIG_NET_CONTEXT_SNDTIMEO=y
CONFIG_NET_CONTEXT_RCVTIMEO=y

# Below section is the primary contributor to SRAM and is currently
# tuned for performance, but this will be revisited in the future.
CONFIG_NET_BUF_RX_COUNT=16
CONFIG_NET_BUF_TX_COUNT=16
CONFIG_NET_BUF_DATA_SIZE=128
CONFIG_NRF70_RX_NUM_BUFS=16
CONFIG_NRF70_MAX_TX_AGGREGATION=4
# nRF700x is main consumer: (16 + 8) * 1600 = ~40KB + ~40KB control path (experimental)
CONFIG_NET_TC_TX_COUNT=1

# MQTT
CONFIG_MQTT_HELPER_PROVISION_CERTIFICATES=y

# Kernel options
CONFIG_REBOOT=y
CONFIG_POSIX_API=y
CONFIG_POSIX_MAX_FDS=21

# Shell
CONFIG_SHELL=y
CONFIG_SHELL_CMDS_RESIZE=n
CONFIG_NET_L2_WIFI_SHELL=y

# Logging
CONFIG_LOG_MODE_IMMEDIATE=y
CONFIG_NET_CONFIG_AUTO_INIT=n

# TLS
CONFIG_NET_SOCKETS_SOCKOPT_TLS=y
CONFIG_NET_SOCKETS_TLS_MAX_CONTEXTS=1
CONFIG_NRF_SECURITY=y
CONFIG_MBEDTLS=y
CONFIG_MBEDTLS_ENABLE_HEAP=y
CONFIG_MBEDTLS_SSL_KEEP_PEER_CERTIFICATE=n
CONFIG_MBEDTLS_SSL_SERVER_NAME_INDICATION=y
CONFIG_TLS_CREDENTIALS=y
CONFIG_TLS_CREDENTIALS_BACKEND_VOLATILE=y

# Stack sizes
CONFIG_NET_CONNECTION_MANAGER_MONITOR_STACK_SIZE=2048
CONFIG_NET_TX_STACK_SIZE=2048
CONFIG_NET_RX_STACK_SIZE=2048
CONFIG_NET_MGMT_EVENT_STACK_SIZE=1024
CONFIG_SYSTEM_WORKQUEUE_STACK_SIZE=3100
CONFIG_NRF70_IRQ_WQ_STACK_SIZE=1024
CONFIG_NRF70_BH_WQ_STACK_SIZE=2300
CONFIG_MQTT_HELPER_STACK_SIZE=4096
CONFIG_SHELL_STACK_SIZE=4400
CONFIG_ISR_STACK_SIZE=512

# Heap sizes
CONFIG_COMMON_LIBC_MALLOC_ARENA_SIZE=21808
CONFIG_MBEDTLS_HEAP_SIZE=54000
CONFIG_HEAP_MEM_POOL_SIZE=87000
CONFIG_HEAP_MEM_POOL_IGNORE_MIN=y
```

## samples/wifi/wifi-serial-bridge/src/modules/serial/Kconfig.serial
```kconfig
#
# Copyright (c) 2023 Nordic Semiconductor
#
# SPDX-License-Identifier: LicenseRef-Nordic-5-Clause
#

menu "Serial"

module = Serial
module-str = Serial
source "subsys/logging/Kconfig.template.log_config"

endmenu # Serial
```

## subsys/debug/cs_trace/Kconfig
```kconfig
#
# Copyright (c) 2023 Nordic Semiconductor
#
# SPDX-License-Identifier: LicenseRef-Nordic-5-Clause
#

config CS_TRACE
	bool "Enable Corsight trace"
	help
	  Enable tracing using Coresight modules such as ETM, ITM and ETB.

if CS_TRACE

config CS_TRACE_SYS_INIT
	bool "Initialize automatically"
	default y

endif # CS_TRACE
```

## subsys/debug/etb_trace/Kconfig
```kconfig
#
# Copyright (c) 2023 Nordic Semiconductor
#
# SPDX-License-Identifier: LicenseRef-Nordic-5-Clause
#

config ETB_TRACE
	bool "Enable ETB trace"
	help
	  Enable tracing using Coresight modules such as ETM, ITM and store them to ETB.

if ETB_TRACE

config ETB_TRACE_SYS_INIT
	bool "Initialize automatically"
	default y

endif # ETB_TRACE
```

## subsys/net/l2_wifi_if_conn/Kconfig
```kconfig
# Copyright (c) 2023 Nordic Semiconductor
#
# SPDX-License-Identifier: LicenseRef-Nordic-5-Clause
#

config L2_WIFI_CONNECTIVITY
	bool "L2 Wi-Fi Connectivity"
	depends on NET_CONNECTION_MANAGER

config L2_WIFI_CONN_WQ_STACK_SIZE
	int
	default 512
```

## subsys/net/lib/azure_fota/Kconfig
```kconfig
#
# Copyright (c) 2020 Nordic Semiconductor
#
# SPDX-License-Identifier: LicenseRef-BSD-5-Clause-Nordic
#

menuconfig AZURE_FOTA
	bool "Azure FOTA library"
	depends on FOTA_DOWNLOAD
	depends on CJSON_LIB
	select DOWNLOAD_CLIENT_TLS

if AZURE_FOTA

config AZURE_FOTA_PAYLOAD_SIZE
	int "MQTT payload reception buffer size for Azure FOTA messages"
	default 1350

config AZURE_FOTA_HOSTNAME_MAX_LEN
	int "Hostname buffer size"
	default 255

config AZURE_FOTA_FILE_PATH_MAX_LEN
	int "File path buffer size"
	default 255

config AZURE_FOTA_DOWNLOAD_SECURITY_TAG
	int "Security tag to be used for downloads"
	default 42

config AZURE_FOTA_DOWNLOAD_PORT
	int "Port number"
	default 443

module=AZURE_FOTA
module-dep=LOG
module-str=Log level for Azure FOTA
module-help=Enables Azure FOTA log messages.
source "${ZEPHYR_BASE}/subsys/logging/Kconfig.template.log_config"

endif # AZURE_FOTA
```

## subsys/net/lib/azure_iot_hub/Kconfig
```kconfig
#
# Copyright (c) 2020 Nordic Semiconductor
#
# SPDX-License-Identifier: LicenseRef-BSD-5-Clause-Nordic
#

menuconfig AZURE_IOT_HUB
	bool "Azure IoT Hub"
	select MQTT_LIB
	select MQTT_LIB_TLS

if AZURE_IOT_HUB

config AZURE_IOT_HUB_NAME
	string "Azure IoT Hub name"

config AZURE_IOT_HUB_NAME_MAX_LEN
	int "Max length for Azure IoT Hub name"
	default 30

config AZURE_IOT_HUB_STATIC_IPV4
	bool "Enable use of static IPv4"

config AZURE_IOT_HUB_STATIC_IPV4_ADDR
	string "Static IPv4 address"
	depends on AZURE_IOT_HUB_STATIC_IPV4

config AZURE_IOT_HUB_SEC_TAG
	int "Security tag where TLS credentials are stored"

config AZURE_IOT_HUB_HOSTNAME
	string "Azure IoT Hub hostname"

config AZURE_IOT_HUB_PORT
	int "Azure IoT Hub port"
	default 8883

config AZURE_IOT_HUB_MQTT_RX_TX_BUFFER_LEN
	int "Buffer sizes for the MQTT library"
	default 256
	help
	  Specifies maximum message size can be transmitted/received through
	  MQTT (exluding MQTT PUBLISH payload).

config AZURE_IOT_HUB_MQTT_PAYLOAD_BUFFER_LEN
	int "Size of the MQTT PUBLISH payload buffer (receiving MQTT messages)."
	default 1024

config AZURE_IOT_HUB_DEVICE_ID_MAX_LEN
	int "Maximum length of device ID"
	default 30

config AZURE_IOT_HUB_DEVICE_ID
	string "Provide device ID compile time"

config AZURE_IOT_HUB_DEVICE_ID_APP
	bool "Device ID provided by application run-time"

config AZURE_IOT_HUB_CONNECTION_POLL_THREAD
	bool "Poll Azure Iot Hub socket in separate thread"
	default y

config AZURE_IOT_HUB_AUTO_DEVICE_TWIN_REQUEST
	bool "Request device automatically when connected"
	default y

config AZURE_IOT_HUB_DPS
	bool "Use Device Provisioning Service"
	select CJSON_LIB
	depends on SETTINGS
	help
	  Enabling DPS will make the device connect to the specified DPS
	  endpoint and retrieve the IoT Hub endpoint to use for telemetry.

if AZURE_IOT_HUB_DPS

config AZURE_IOT_HUB_DPS_ID_SCOPE
	string "DPS ID scope"

config AZURE_IOT_HUB_DPS_REG_ID
	string "DPS registration ID"

config AZURE_IOT_HUB_DPS_HOSTNAME
	string "DPS host name"
	default "global.azure-devices-provisioning.net"

endif # AZURE_IOT_HUB_DPS

module=AZURE_IOT_HUB
module-dep=LOG
module-str=Azure IoT Hub
source "${ZEPHYR_BASE}/subsys/logging/Kconfig.template.log_config"

endif # AZURE_IOT_HUB
```

## subsys/net/lib/nrf_cloud/Kconfig
```kconfig
# Copyright (c) 2018 Nordic Semiconductor
#
# SPDX-License-Identifier: LicenseRef-Nordic-5-Clause
#

menuconfig NRF_CLOUD
	bool "nRF Cloud Library"
	select CJSON_LIB

if NRF_CLOUD

config NRF_CLOUD_SEC_TAG
	int "Security tag to use for nRF Cloud connection"
	default 16842753

config NRF_CLOUD_HOST_NAME
	string "nRF Cloud MQTT server hostname"
	default "a2n7tk1kp18wix-ats.iot.us-east-1.amazonaws.com"

rsource "Kconfig.nrf_cloud_mqtt"
rsource "Kconfig.nrf_cloud_rest"
rsource "Kconfig.nrf_cloud_agps"
rsource "Kconfig.nrf_cloud_pgps"

config NRF_CLOUD_CELL_POS
	bool "nRF Cloud Cellular Positioning"
	imply FPU
	depends on MODEM_INFO
	depends on MODEM_INFO_ADD_NETWORK

if NRF_CLOUD_AGPS || NRF_CLOUD_PGPS

module = NRF_CLOUD_GPS
module-str = nRF Cloud GPS Assistance
source "subsys/logging/Kconfig.template.log_config"

endif

module=NRF_CLOUD
module-dep=LOG
module-str=Log level for nRF Cloud
module-help=Enables nRF Cloud log messages.
source "subsys/logging/Kconfig.template.log_config"

endif # NRF_CLOUD
```

## subsys/net/lib/nrf_cloud/Kconfig.nrf_cloud_agps
```kconfig
# Copyright (c) 2021 Nordic Semiconductor
#
# SPDX-License-Identifier: LicenseRef-Nordic-5-Clause
#

menuconfig NRF_CLOUD_AGPS
	bool "nRF Cloud Assisted GPS (A-GPS)"
	depends on NRF9160_GPS
	depends on MODEM_INFO
	depends on MODEM_INFO_ADD_NETWORK

if NRF_CLOUD_AGPS

config NRF_CLOUD_AGPS_AUTO
	bool "Automatically request A-GPS on bootup"

module = NRF_CLOUD_AGPS
module-str = nRF Cloud A-GPS
source "subsys/logging/Kconfig.template.log_config"

endif # NRF_CLOUD_AGPS
```
