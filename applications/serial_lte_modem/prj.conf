## Kconfig
```
#
# Copyright (c) 2019 Nordic Semiconductor
#
# SPDX-License-Identifier: LicenseRef-Nordic-5-Clause
#

source "Kconfig.zephyr"

menu "Nordic Serial LTE Modem"

config SLM_CUSTOMIZED
	bool "Flag for customized functionality"
	select SLM_HW_REV
	help
	  Enable this flag to include customized logic.

config SLM_WATCHDOG_SYSTEM_WORKQUEUE_TIMEOUT_MSEC
	int "Watchdog timeout in milliseconds for system workqueue"
	default 60000
	help
	  Timeout for system workqueue watchdog. This is used to monitor the responsiveness
	  of the system workqueue, which in many cases is used by SLM for sending AT commands to the
	  modem. Make sure that this value is higher than the longest expected time for the AT
	  command to be processed by the modem.

config SLM_AT_MODE
	bool "Serial LTE Modem by raw AT mode"
	default y
	select AT_CMD
	select AT_NOTIF
	select AT_CMD_PARSER

config SLM_AT_MAX_PARAM
	int "Maximum number of parameters in AT command"
	default 9

menuconfig SLM_NATIVE_TLS
	bool "Use Zephyr mbedTLS"

config SLM_UART_HWFC_RUNTIME
	bool "Support of UART HWFC runtime configuration"

if SLM_NATIVE_TLS

choice
	prompt "Credential storage backend"
	default SLM_NATIVE_TLS_PS if TFM_PARTITION_PROTECTED_STORAGE
	default SLM_NATIVE_TLS_MODEM
	help
		Select which mechanism is used to store credentials
	config SLM_NATIVE_TLS_MODEM
		bool "Modem storage"
		help
		  Credentials will be stored in the nRF9160 modem's storage.
		  Security tag value will be offset and CA certificate slots are
		  used. For details, see the slm_tls_map_sectag function.
	config SLM_NATIVE_TLS_PS
		bool "Protected Storage (TF-M)"
		depends on TFM_PARTITION_PROTECTED_STORAGE
		help
		  Credentials will be stored using the PSA Protected Storage
		  API. This requires that the application be built with TF-M.
endchoice

if SLM_NATIVE_TLS_PS
config SLM_NATIVE_TLS_PS_WRITE_ONCE
	bool "Write-once credentials"
	default y
	help
		Credentials are written with the "write-once" attribute, meaning
		that they cannot be modified, replaced or deleted by firmware.
endif

endif # SLM_NATIVE_TLS


#
# external XTAL for UART
#
config SLM_EXTERNAL_XTAL
	bool "Use external XTAL for UARTE"
	default y

#
# Inter-Connect
#
choice
	prompt "UART for interconnect"
	default SLM_CONNECT_UART_0
	help
		Selects which UART to use for interconnect:
		-  UART 0
		-  UART 2
	config SLM_CONNECT_UART_0
		bool "UART 0"
	  select UART_0_NRF_HW_ASYNC
	  select SLM_UART_HWFC_RUNTIME if $(dt_node_has_prop,uart0,rts-pin) && \
					  $(dt_node_has_prop,uart0,cts-pin)
	config SLM_CONNECT_UART_2
		bool "UART 2"
	  select UART_2_NRF_UARTE
	  select UART_2_NRF_HW_ASYNC
	  select SLM_UART_HWFC_RUNTIME if $(dt_node_has_prop,uart2,rts-pin) && \
					  $(dt_node_has_prop,uart2,cts-pin)
endchoice

choice
	prompt "Termination mode"
	default SLM_CR_LF_TERMINATION
	help
		Sets the command terminator used by the serial terminal.
		Available options are:
		-  CR termination
		-  LF termination
		-  CR+LF termination
	config SLM_CR_TERMINATION
		bool "CR termination"
	config SLM_LF_TERMINATION
		bool "LF termination"
	config SLM_CR_LF_TERMINATION
		bool "CR+LF termination"
endchoice

#
# GPIO wakeup
#
config SLM_GPIO_WAKEUP
	bool "Support of GPIO wakeup"
	default y
	help
	  Enable GPIO wakeup on nRF9160 side.

if SLM_GPIO_WAKEUP

config SLM_START_SLEEP
	bool "Enter sleep on startup"
	help
	  Put nRF9160 into deep sleep mode after startup.

endif

config SLM_INTERFACE_PIN
	int "Interface GPIO to wake up or exit idle mode"
	default 6 if SLM_CONNECT_UART_0
	default 31 if SLM_CONNECT_UART_2

#
# Socket
#
config SLM_SOCKET_RX_MAX
	int "Maximum RX buffer size for receiving socket data"
	range 576 708
	default 576
	help
	  Default: NET_IPV4_MTU (576)
	  Maximum: MSS setting in modem (708)

#
# TCP/TLS proxy
#
config SLM_TCP_FILTER_SIZE
	int "Size of IPv4/IPv6 address allowlist"
	range 1 6
	default 6

config SLM_TCP_POLL_TIME
	int "Poll time-out in seconds for TCP connection"
	default 10

config SLM_UDP_POLL_TIME
	int "Poll time-out in seconds for UDP connection"
	default 10

config SLM_TCP_CONN_TIME
	int "Connection time-out in seconds for TCP server"
	default 60

config SLM_DATAMODE_HWFC
	bool "UART HWFC for data mode"
	default y
	help
	  Require UART hardware flow control for data mode

config SLM_DATAMODE_TERMINATOR
	string "Pattern string to terminate data mode"
	default "+++"
	help
	  Use a pattern to terminate data mode

config SLM_DATAMODE_SILENCE
	int "Silence time to exit data mode"
	default 1
	help
	  Exit data mode after the specified time (in seconds) of UART silence

#
# Configurable services
#
config SLM_SMS
	bool "SMS support in SLM"
	default y
	select SMS
	help
	  Support SMS send/receive in plain text

rsource "src/gps/Kconfig"
rsource "src/ftp_c/Kconfig"
rsource "src/mqtt_c/Kconfig"
rsource "src/http_c/Kconfig"
rsource "src/twi/Kconfig"
rsource "src/gpio/Kconfig"
rsource "src/ui/Kconfig"
rsource "src/hw_rev/Kconfig"
rsource "src/user_config/Kconfig"

module = SLM
module-str = serial modem
source "${ZEPHYR_BASE}/subsys/logging/Kconfig.template.log_config"

endmenu
```

## prj.conf
```kconfig
#
# Copyright (c) 2020 Nordic Semiconductor ASA
#
# SPDX-License-Identifier: LicenseRef-Nordic-5-Clause
#
# General config
CONFIG_LOG=y
CONFIG_LOG_DEFAULT_LEVEL=3
CONFIG_STACK_SENTINEL=y
CONFIG_NEWLIB_LIBC=y
CONFIG_NEWLIB_LIBC_FLOAT_PRINTF=y
CONFIG_RING_BUFFER=y
CONFIG_FPU=y

# Modem trace. Enable the options below to enable modem trace.
CONFIG_NRF_MODEM_LIB_TRACE_ENABLED=y
CONFIG_NRF_MODEM_LIB_TRACE_MEDIUM_RTT=y

# Segger RTT
CONFIG_USE_SEGGER_RTT=y
CONFIG_RTT_CONSOLE=y
CONFIG_UART_CONSOLE=n
CONFIG_LOG_BACKEND_RTT=y
CONFIG_LOG_BACKEND_UART=n

# Network
CONFIG_NETWORKING=y
CONFIG_NET_SOCKETS=y
CONFIG_NET_NATIVE=n

# Modem library
CONFIG_NRF_MODEM_LIB=y
CONFIG_NRF_MODEM_LIB_SYS_INIT=n
CONFIG_AT_CMD_SYS_INIT=n
CONFIG_AT_NOTIF_SYS_INIT=n
# Align the max FD entry to NRF_MODEM_MAX_SOCKET_COUNT(8)
CONFIG_POSIX_MAX_FDS=8
# Enable below for modem trace
# CONFIG_NRF_MODEM_LIB_TRACE_ENABLED=y

# UART interface
CONFIG_SERIAL=y
CONFIG_UART_ASYNC_API=y
CONFIG_NRFX_TIMER2=y

# Stacks and heaps
CONFIG_MAIN_STACK_SIZE=4096
CONFIG_HEAP_MEM_POOL_SIZE=16384
CONFIG_SYSTEM_WORKQUEUE_STACK_SIZE=4096

# AT_CMD
# Enable AT_CMD debug for details
#CONFIG_AT_CMD_LOG_LEVEL_DBG=y

# Device power management
CONFIG_PM_DEVICE=y

# Enable SUPL client support
#CONFIG_SUPL_CLIENT_LIB=y

# FOTA
CONFIG_HTTP_PARSER_URL=y
CONFIG_FOTA_DOWNLOAD=y
CONFIG_FOTA_DOWNLOAD_PROGRESS_EVT=y
CONFIG_DFU_TARGET=y
CONFIG_DOWNLOAD_CLIENT=y
CONFIG_DOWNLOAD_CLIENT_STACK_SIZE=4096
CONFIG_IMG_MANAGER=y
CONFIG_IMG_ERASE_PROGRESSIVELY=y

# Placeholder partition to match the following layout:
# +-----------------------------------------------------+
# | 0x0: mcuboot (0x8000 - 32kB)                        |
# | 0x8000: mcuboot_primary (0x70000 - 448kB)           |
# | 0x78000: mcuboot_secondary (0x70000 - 448kB)        |
# | 0xe8000: placeholder/TFM_EXTRA (0x16000 - 88kB)     |
# | 0xfe000: settings_storage (0x2000 - 8kB)            |
# +-----------------------------------------------------+
#CONFIG_PM_PLACEHOLDER=y
#CONFIG_PM_PARTITION_SIZE_PLACEHOLDER=0x16000

# Serial DFU
CONFIG_MCUMGR=y
CONFIG_MCUMGR_SMP_UART=y
CONFIG_UART_MCUMGR_RX_BUF_SIZE=512
CONFIG_MCUMGR_BUF_SIZE=512
## Required by the `taskstat` command.
CONFIG_THREAD_MONITOR=y
CONFIG_STATS=y
CONFIG_STATS_NAMES=y
CONFIG_MGMT_FMFU=y
CONFIG_MCUMGR_CMD_OS_MGMT=y
CONFIG_MCUMGR_CMD_STAT_MGMT=y
CONFIG_MCUMGR_CMD_IMG_MGMT=y

# FLASH
CONFIG_FLASH=y
CONFIG_FLASH_PAGE_LAYOUT=y
CONFIG_FLASH_MAP=y

# Watchdog
CONFIG_WATCHDOG=y
CONFIG_TASK_WDT=y
CONFIG_TASK_WDT_CHANNELS=2
CONFIG_TASK_WDT_MIN_TIMEOUT=10000


#
# SLM-specific configurations
#
CONFIG_SLM_CUSTOMIZED=y
CONFIG_SLM_LOG_LEVEL_INF=y
CONFIG_SLM_EXTERNAL_XTAL=n
CONFIG_SLM_START_SLEEP=n
CONFIG_SLM_DATAMODE_HWFC=n
# Use UART_0 (when working with PC terminal)
#CONFIG_UART_0_NRF_HW_ASYNC_TIMER=2
# Use UART_2 (when working with external MCU)
CONFIG_SLM_CONNECT_UART_2=y
CONFIG_UART_2_NRF_HW_ASYNC_TIMER=2
CONFIG_UART_2_INTERRUPT_DRIVEN=n

CONFIG_SLM_UI=y
CONFIG_SLM_CUSTOMIZED_RS232=y

# TF-M
CONFIG_BOOTLOADER_MCUBOOT=y
CONFIG_BUILD_WITH_TFM=y
CONFIG_TFM_MCUBOOT_IMAGE_NUMBER=1
CONFIG_PM_PARTITION_SIZE_TFM=0x28000
CONFIG_PM_PARTITION_SIZE_TFM_EXTRA=0x16000
CONFIG_SLM_NATIVE_TLS_PS_WRITE_ONCE=n
CONFIG_SLM_HTTPC=n
CONFIG_SLM_MQTTC=n
CONFIG_SLM_GPS=n

#
#CONFIG_SLM_LOG_LEVEL_DBG=y
CONFIG_SLM_RI_PIN=17
CONFIG_I2C=y
CONFIG_SLM_UI_LTE_STATE_PIN=0
CONFIG_SLM_UI_DATA_ACTIVITY_PIN=1
CONFIG_SLM_UI_LTE_SIGNAL_PIN=2
CONFIG_SLM_UI_DIAG_PIN=3
CONFIG_SLM_MOD_FLASH_PIN=24


CONFIG_SEGGER_RTT_BUFFER_SIZE_UP=8192
CONFIG_NRF_MODEM_LIB_TRACE_MEDIUM_RTT_BUF_SIZE=4096
```

## boards/thingy91x_nrf9161_ns.conf
```kconfig
#
# Copyright (c) 2023 Nordic Semiconductor ASA
#
# SPDX-License-Identifier: LicenseRef-Nordic-5-Clause
#

# Configuration file for Thingy:91 X.
# This file is merged with prj.conf in the application folder, and options
# set here will take precedence if they are present in both files.

# Configuration related to external sensors.
CONFIG_UART_0_NRF_HW_ASYNC_TIMER=2
CONFIG_UART_0_NRF_HW_ASYNC=y
CONFIG_SLM_WAKEUP_PIN=26
```

## nrf9160_ecmns_dfu.overlay
```dts
&uart0 {
	current-speed = <1000000>;
	tx-pin = <29>;
	rx-pin = <28>;
	// status = "disabled";
};

&uart2 {
		compatible = "nordic,nrf-uarte";
		current-speed = <19200>;
		status = "okay";
	tx-pin = <29>;
	rx-pin = <28>;
	rts-pin = < 0x1b >;
	cts-pin = < 0x1a >;
	hw-flow-control;

	// /delete-property/ rts-pin;
	// /delete-property/ cts-pin;
};
```

## nrf9160dk_nrf9160ns.overlay
```dts
&uart0 {
	status = "disabled";
	current-speed = <115200>;
	tx-pin = <29>;
	rx-pin = <28>;
	/delete-property/ rts-pin;
	/delete-property/ cts-pin;
};

&uart1 {
	status = "disabled";
};

&uart2 {
	compatible = "nordic,nrf-uarte";
	current-speed = <19200>;
	status = "okay";
	tx-pin = <29>;
	rx-pin = <28>;
	rts-pin = < 0x1b >;
	cts-pin = < 0x1a >;
	hw-flow-control;
};

&i2c2 {
	status = "disabled";
};
```

## boards/thingy91x_nrf9161_ns.overlay
```dts
/*
 * Copyright (c) 2023 Nordic Semiconductor ASA
 *
 * SPDX-License-Identifier: LicenseRef-Nordic-5-Clause
 */

/ {
	chosen {
		ncs,slm-uart = &uart0;
	};
};

&i2c2 {
	status = "okay";
};

&button0 {
	status = "disabled";
};
```

## src/main.c
```c
/*
 * Copyright (c) 2019 Nordic Semiconductor ASA
 *
 * SPDX-License-Identifier: LicenseRef-Nordic-5-Clause
 */
#include <logging/log.h>
#include <logging/log_ctrl.h>

#include <zephyr.h>
#include <stdio.h>
#include <drivers/uart.h>
#include <drivers/gpio.h>
#include <string.h>
#include <nrf_modem.h>
#include <hal/nrf_gpio.h>
#include <hal/nrf_power.h>
#include <hal/nrf_regulators.h>
#include <hal/nrf_uarte.h>
#include <modem/nrf_modem_lib.h>
#include <modem/at_notif.h>
#include <dfu/mcuboot.h>
#include <dfu/dfu_target.h>
#include <sys/reboot.h>
#include <drivers/clock_control.h>
#include <drivers/clock_control/nrf_clock_control.h>
#include <mgmt/fmfu_mgmt.h>
#include <mgmt/fmfu_mgmt_stat.h>
#include "os_mgmt/os_mgmt.h"
#include "img_mgmt/img_mgmt.h"
#include "slm_at_host.h"
#include "slm_at_fota.h"
#include "slm_util.h"

LOG_MODULE_REGISTER(app, CONFIG_SLM_LOG_LEVEL);

#define SLM_DFU_STATUS          0xBC  /* Flag to be saved in GPREGRET[0]*/
#define BUTTONLESS_DFU                /* Flag to support buttonless DFU */

#define SLM_WQ_STACK_SIZE       KB(2)
#define SLM_WQ_PRIORITY         K_LOWEST_APPLICATION_THREAD_PRIO
static K_THREAD_STACK_DEFINE(slm_wq_stack_area, SLM_WQ_STACK_SIZE);

static const struct device *gpio_dev;
static struct gpio_callback gpio_cb;
static struct k_work exit_idle_work;
static bool full_idle_mode;

/* global variable used across different files */
struct k_work_q slm_work_q;

/* global variable defined in different files */
extern uint8_t fota_type;
extern uint8_t fota_stage;
extern uint8_t fota_status;
extern int32_t fota_info;

/* global functions defined in different files */
int poweron_uart(bool sync_str);
int slm_settings_init(void);
int slm_setting_fota_save(void);

/**@brief Recoverable modem library error. */
void nrf_modem_recoverable_error_handler(uint32_t err)
{
	LOG_ERR("Modem library recoverable error: %u", err);

	/* Recoverable modem library error, reboot to recover */
	slm_util_reboot(1);
}

static void exit_idle(struct k_work *work)
{
	int err;

	LOG_INF("Exit idle, full mode: %d", full_idle_mode);
	(void)gpio_pin_interrupt_configure(gpio_dev, CONFIG_SLM_INTERFACE_PIN,
				     GPIO_INT_DISABLE);
	gpio_remove_callback(gpio_dev, &gpio_cb);
	/* Do the same as nrf_gpio_cfg_default() */
	(void)gpio_pin_configure(gpio_dev, CONFIG_SLM_INTERFACE_PIN, GPIO_INPUT);

	if (full_idle_mode) {
		/* Restart SLM services */
		err = slm_at_host_init();
		if (err) {
			LOG_ERR("Failed to init at_host: %d", err);
		}
	} else {
		/* Power on UART only */
		err = poweron_uart(true);
		if (err) {
			LOG_ERR("Failed to wake up uart: %d", err);
		}
	}
}

static void gpio_callback(const struct device *dev,
		     struct gpio_callback *gpio_cb, uint32_t pins)
{
	k_work_submit_to_queue(&slm_work_q, &exit_idle_work);
}

void enter_idle(bool full_idle)
{
	int err;

	gpio_dev = device_get_binding(DT_LABEL(DT_NODELABEL(gpio0)));
	if (gpio_dev == NULL) {
		LOG_ERR("GPIO_0 bind error");
		return;
	}
	err = gpio_pin_configure(gpio_dev, CONFIG_SLM_INTERFACE_PIN,
				GPIO_INPUT | GPIO_PULL_UP);
	if (err) {
		LOG_ERR("GPIO_0 config error: %d", err);
		return;
	}
	gpio_init_callback(&gpio_cb, gpio_callback,
			BIT(CONFIG_SLM_INTERFACE_PIN));
	err = gpio_add_callback(gpio_dev, &gpio_cb);
	if (err) {
		LOG_ERR("GPIO_0 add callback error: %d", err);
		return;
	}
	err = gpio_pin_interrupt_configure(gpio_dev, CONFIG_SLM_INTERFACE_PIN,
					   GPIO_INT_LEVEL_LOW);
	if (err) {
		LOG_ERR("GPIO_0 enable callback error: %d", err);
		return;
	}

	full_idle_mode = full_idle;
}

void enter_sleep(void)
{
	//nrf_modem_lib_shutdown();

	/*
	 * Due to errata 4, Always configure PIN_CNF[n].INPUT before PIN_CNF[n].SENSE.
	 */
	nrf_gpio_cfg_input(CONFIG_SLM_INTERFACE_PIN,
		NRF_GPIO_PIN_PULLUP);
	nrf_gpio_cfg_sense_set(CONFIG_SLM_INTERFACE_PIN,
		NRF_GPIO_PIN_SENSE_LOW);

	nrf_regulators_system_off(NRF_REGULATORS_NS);
}

void enter_dfu(void)
{
	//nrf_modem_lib_shutdown();

	nrf_power_gpregret_set(NRF_POWER_NS, SLM_DFU_STATUS);
	slm_util_reboot(0);
}

void handle_nrf_modem_lib_init_ret(int ret)
{
	/* Handle return values relating to modem firmware update */
	switch (ret) {
	case 0:
		return; /* Initialization successful, no action required. */
	case MODEM_DFU_RESULT_OK:
		LOG_INF("MODEM UPDATE OK. Will run new firmware");
		fota_stage = FOTA_STAGE_COMPLETE;
		fota_status = FOTA_STATUS_OK;
		fota_info = 0;
		break;
	case MODEM_DFU_RESULT_UUID_ERROR:
	case MODEM_DFU_RESULT_AUTH_ERROR:
		LOG_ERR("MODEM UPDATE ERROR %d. Will run old firmware", ret);
		fota_status = FOTA_STATUS_ERROR;
		fota_info = ret;
		break;
	case MODEM_DFU_RESULT_HARDWARE_ERROR:
	case MODEM_DFU_RESULT_INTERNAL_ERROR:
		LOG_ERR("MODEM UPDATE FATAL ERROR %d. Modem failiure", ret);
		fota_status = FOTA_STATUS_ERROR;
		fota_info = ret;
		break;
	default:
		/* All non-zero return codes other than DFU result codes are
		 * considered irrecoverable and a reboot is needed.
		 */
		LOG_ERR("nRF modem lib initialization failed, error: %d", ret);
		fota_status = FOTA_STATUS_ERROR;
		fota_info = ret;
		break;
	}

	slm_setting_fota_save();
	LOG_WRN("Rebooting...");

	slm_util_reboot(1);
}

void start_execute(void)
{
	int err;
#if defined(CONFIG_SLM_EXTERNAL_XTAL)
	struct onoff_manager *clk_mgr;
	struct onoff_client cli = {};
#endif

	LOG_INF("Serial LTE Modem");

#if defined(CONFIG_SLM_EXTERNAL_XTAL)
	/* request external XTAL for UART */
	clk_mgr = z_nrf_clock_control_get_onoff(CLOCK_CONTROL_NRF_SUBSYS_HF);
	sys_notify_init_spinwait(&cli.notify);
	err = onoff_request(clk_mgr, &cli);
	if (err) {
		LOG_ERR("Clock request failed: %d", err);
		return;
	}
#endif

	/* Init and load settings */
	err = slm_settings_init();
	if (err) {
		LOG_ERR("Failed to init slm settings: %d", err);
		return;
	}

	/* Modem Post-FOTA handling */
	err = nrf_modem_lib_init(NORMAL_MODE);
	handle_nrf_modem_lib_init_ret(err);

	/* Init at_cmd and at_notify lib */
	err = at_cmd_init();
	if (err) {
		LOG_ERR("Failed to init at cmd: %d", err);
		return;
	}
	err = at_notif_init();
	if (err) {
		LOG_ERR("Failed to init at notify: %d", err);
		return;
	}

#if defined(CONFIG_NRF_MODEM_LIB_TRACE_ENABLED)
	/* Enable modem trace */
	static const char mdm_trace[] = "AT%XMODEMTRACE=1,2";

	if (at_cmd_write(mdm_trace, NULL, 0, NULL) != 0) {
		LOG_ERR("Failed to enable modem trace");
	}

#if defined(CONFIG_NRF_MODEM_LIB_TRACE_MEDIUM_RTT) && defined(CONFIG_NRF_MODEM_LIB_TRACE_RTT_DIAGNOSTICS)
	/* Print initial RTT trace buffer status */
	nrf_modem_lib_trace_rtt_diagnose();
#endif
#endif

	if (fota_type == DFU_TARGET_IMAGE_TYPE_MCUBOOT) {
		/* All initializations were successful mark image as working so that we
		 * will not revert upon reboot.
		 */
		err = boot_write_img_confirmed();
		if (fota_stage != FOTA_STAGE_INIT) {
			if (err) {
				fota_status = FOTA_STATUS_ERROR;
				fota_info = err;
			} else {
				fota_stage = FOTA_STAGE_COMPLETE;
				fota_status = FOTA_STATUS_OK;
				fota_info = 0;
			}
		}
	}

	err = slm_at_host_init();
	if (err) {
		LOG_ERR("Failed to init at_host: %d", err);
		return;
	}

	k_work_queue_start(&slm_work_q, slm_wq_stack_area,
			   K_THREAD_STACK_SIZEOF(slm_wq_stack_area),
			   SLM_WQ_PRIORITY, NULL);
	k_work_init(&exit_idle_work, exit_idle);
}

void start_dfu_execute(void)
{
	int err;

	/* Initialize modem in DFU mode */
	err = nrf_modem_lib_init(FULL_DFU_MODE);
	if (err) {
		LOG_ERR("Error in modem lib init: %d", err);
		return;
	}

	/* Register SMP Communication stats */
	fmfu_mgmt_stat_init();
	/* Registers the OS management command handler group */
	os_mgmt_register_group();
	/* Registers the image management command handler group */
	img_mgmt_register_group();
	/* Initialize MCUMgr handlers for full modem update */
	err = fmfu_mgmt_init();
	if (err) {
		LOG_ERR("Error in fmfu init: %d", err);
		return;
	}
#if MCUMGR_CONFIRM_IMAGE
	/** Need to keep in DFU mode if mcumgr would test then confirm image,
	 *  Which means two Reset by mcumgr to boot back to SLM mode
	 */
	if (boot_is_img_confirmed()) {
		LOG_INF("Current image confirmed");
		nrf_power_gpregret_set(NRF_POWER_NS, 0x00);
	} else {
		LOG_INF("Current image not confirmed yet");
	}
#else
	/** Exit DFU mode directly if mcumgr would confirm image only,
	 *  Which means one final Reset by mcumgr to boot back to SLM mode
	 */
	nrf_power_gpregret_set(NRF_POWER_NS, 0x00);
#endif
	LOG_INF("Enter DFU mode");
}

#if defined(CONFIG_SLM_START_SLEEP)
int main(void)
{
	uint32_t rr = nrf_power_resetreas_get(NRF_POWER_NS);
	uint8_t gp = nrf_power_gpregret_get(NRF_POWER_NS);

	LOG_DBG("RR: 0x%08x", rr);
	if (rr & NRF_POWER_RESETREAS_OFF_MASK) {
		nrf_power_resetreas_clear(NRF_POWER_NS, 0x70017);
		if (gp == SLM_DFU_STATUS) {
			nrf_uarte_disable(NRF_UARTE2);
			start_dfu_execute();
		} else {
			nrf_uarte_disable(NRF_UARTE0);
			nrf_uarte_enable(NRF_UARTE2);
			start_execute();
		}
	} else {
		LOG_INF("Sleep");
		enter_sleep();
	}

	return 0;
}
#else
int main(void)
{
#if defined(BUTTONLESS_DFU)
	uint8_t gp;

	gp = nrf_power_gpregret_get(NRF_POWER_NS);
	LOG_INF("GP: 0x%02x", gp);
	if (gp == SLM_DFU_STATUS) {
		nrf_uarte_disable(NRF_UARTE2);
		start_dfu_execute();
	} else {
		nrf_uarte_disable(NRF_UARTE0);
		nrf_uarte_enable(NRF_UARTE2);
		start_execute();
	}
#else
#define DFU_PIN 6
	int run_dfu;

	gpio_dev = device_get_binding(DT_LABEL(DT_NODELABEL(gpio0)));
	gpio_pin_configure(gpio_dev, DFU_PIN, GPIO_INPUT | GPIO_PULL_UP);
	k_sleep(K_MSEC(100));
	run_dfu = gpio_pin_get(gpio_dev, DFU_PIN);
	LOG_INF("run_slm: %d", run_dfu);
	if (run_dfu == 0) {
		nrf_uarte_disable(NRF_UARTE2);
		start_dfu_execute();
	} else {
		nrf_uarte_disable(NRF_UARTE0);
		nrf_uarte_enable(NRF_UARTE2);
		start_execute();
	}
#endif
	return 0;
}
#endif	/* CONFIG_SLM_GPIO_WAKEUP */
```

## src/slm_at_host.c
```c
/*
 * Copyright (c) 2019 Nordic Semiconductor ASA
 *
 * SPDX-License-Identifier: LicenseRef-Nordic-5-Clause
 */

#include <zephyr.h>
#include <stdio.h>
#include <ctype.h>
#include <logging/log.h>
#include <drivers/uart.h>
#include <hal/nrf_uarte.h>
#include <sys/ring_buffer.h>
#include <sys/util.h>
#include <string.h>
#include <init.h>
#include <modem/at_cmd.h>
#include <modem/at_notif.h>
#include <hal/nrf_power.h>
#if defined(CONFIG_SLM_CUSTOMIZED_RS232)
#include <hal/nrf_gpio.h>
#endif
#if defined(CONFIG_SLM_DIAG)
#include "slm_diag.h"
#endif

LOG_MODULE_REGISTER(at_host, CONFIG_SLM_LOG_LEVEL);

#include "slm_util.h"
#include "slm_at_host.h"
#include "slm_at_fota.h"

#define OK_STR		"\r\nOK\r\n"
#define ERROR_STR	"\r\nERROR\r\n"
#define FATAL_STR	"FATAL ERROR\r\n"
#define SLM_SYNC_STR	"Ready\r\n"
#define SLM_WDRESET_STR	"\r\n#WDRESET\r\n"

/** The maximum allowed length of an AT command passed through the SLM
 *  The space is allocated statically. This limit is in turn limited by
 *  Modem library's NRF_MODEM_AT_MAX_CMD_SIZE */
#define AT_MAX_CMD_LEN          4096

#define UART_RX_BUF_NUM         2
#define UART_RX_LEN             256
#define UART_RX_TIMEOUT_MS      3
#define UART_ERROR_DELAY_MS     500
#define UART_RX_MARGIN_MS       10

#define HEXDUMP_DATAMODE_MAX    16

static enum slm_operation_modes {
	SLM_AT_COMMAND_MODE,  /* AT command host or bridge */
	SLM_DATA_MODE,        /* Raw data sending */
} slm_operation_mode;

static const struct device *uart_dev;
static uint8_t at_buf[AT_MAX_CMD_LEN];
static uint16_t at_buf_len;
static bool at_buf_overflow;
static struct ring_buf data_rb;
static bool datamode_off_pending;
static bool datamode_rx_disabled;
static slm_datamode_handler_t datamode_handler;
static struct k_work raw_send_work;
static struct k_work cmd_send_work;

static uint8_t uart_rx_buf[UART_RX_BUF_NUM][UART_RX_LEN];
static uint8_t *next_buf;
static uint8_t *uart_tx_buf;
static bool uart_recovery_pending;
static struct k_work_delayable uart_recovery_work;

static K_SEM_DEFINE(tx_done, 0, 1);

/* global functions defined in different files */
int slm_at_parse(const char *at_cmd);
int slm_at_init(void);
void slm_at_uninit(void);
int slm_setting_uart_save(void);

/* global variable used across different files */
struct at_param_list at_param_list;         /* For AT parser */
char rsp_buf[CONFIG_AT_CMD_RESPONSE_MAX_LEN]; /* SLM URC and socket data */
uint8_t rx_data[CONFIG_SLM_SOCKET_RX_MAX];  /* Socket RX raw data */
uint16_t datamode_time_limit;               /* Send trigger by time in data mode */

/* global variable defined in different files */
extern bool uart_configured;
extern struct uart_config slm_uart;

static int uart_send(const uint8_t *str, size_t len)
{
	int ret;

	k_sem_take(&tx_done, K_FOREVER);

	uart_tx_buf = k_malloc(len);
	if (uart_tx_buf == NULL) {
		LOG_WRN("No ram buffer");
		k_sem_give(&tx_done);
		return -ENOMEM;
	}

	memcpy(uart_tx_buf, str, len);
	ret = uart_tx(uart_dev, uart_tx_buf, len, SYS_FOREVER_MS);
	if (ret) {
		LOG_WRN("uart_tx failed: %d", ret);
		k_free(uart_tx_buf);
		k_sem_give(&tx_done);
	}

	return ret;
}

void rsp_send(const uint8_t *str, size_t len)
{
	if (len == 0) {
		return;
	}

	LOG_HEXDUMP_DBG(str, len, "TX");
	(void)uart_send(str, len);
}

static int uart_receive(void)
{
	int ret;

	ret = uart_rx_enable(uart_dev, uart_rx_buf[0], sizeof(uart_rx_buf[0]), UART_RX_TIMEOUT_MS);
	if (ret) {
		LOG_ERR("UART RX failed: %d", ret);
		rsp_send(FATAL_STR, sizeof(FATAL_STR) - 1);
		return ret;
	}
	next_buf = uart_rx_buf[1];
	at_buf_overflow = false;
	at_buf_len = 0;

	return 0;
}

static void uart_recovery(struct k_work *work)
{
	ARG_UNUSED(work);

	(void)uart_receive();
	uart_recovery_pending = false;
	LOG_DBG("UART recovered");
}

int enter_datamode(slm_datamode_handler_t handler)
{
	if (handler == NULL || datamode_handler != NULL) {
		LOG_INF("Invalid, not enter datamode");
		return -EINVAL;
	}

	ring_buf_init(&data_rb, sizeof(at_buf), at_buf);
	datamode_handler = handler;
	slm_operation_mode = SLM_DATA_MODE;
	LOG_INF("Enter datamode");

	return 0;
}

bool exit_datamode(void)
{
	if (slm_operation_mode == SLM_DATA_MODE) {
		ring_buf_reset(&data_rb);
		/* reset UART to restore command mode */
		uart_rx_disable(uart_dev);
		k_sleep(K_MSEC(10));
		(void) uart_receive();
		slm_operation_mode = SLM_AT_COMMAND_MODE;
		datamode_handler = NULL;
		LOG_INF("Exit datamode");
		return true;
	}

	return false;
}

int poweroff_uart(void)
{
	int err;

	uart_rx_disable(uart_dev);
	k_sleep(K_MSEC(100));
	err = pm_device_state_set(uart_dev, PM_DEVICE_STATE_OFF, NULL, NULL);
	if (err) {
		LOG_ERR("Can't power off uart: %d", err);
	}

	return err;
}

int poweron_uart(bool sync_str)
{
	int err;
	uint32_t current_state = 0;

	err = pm_device_state_get(uart_dev, &current_state);
	if (err) {
		LOG_ERR("Device get power_state: %d", err);
		return err;
	}

	if (current_state != PM_DEVICE_STATE_ACTIVE) {
		pm_device_state_set(uart_dev, PM_DEVICE_STATE_ACTIVE, NULL, NULL);
		k_sleep(K_MSEC(100));
		err = uart_receive();
		if (err == 0) {
			k_sem_give(&tx_done);
			if (sync_str) {
				rsp_send(SLM_SYNC_STR, sizeof(SLM_SYNC_STR)-1);
			}
		}
	}

	return err;
}

bool check_uart_flowcontrol(void)
{
	return (slm_uart.flow_ctrl == UART_CFG_FLOW_CTRL_RTS_CTS);
}

int slm_uart_configure(uint32_t baudrate, uint8_t hwfc)
{
	int err;

	LOG_DBG("Set uart baudrate to: %d", baudrate);

	slm_uart.baudrate = baudrate;
	slm_uart.flow_ctrl = hwfc;
	err = uart_configure(uart_dev, &slm_uart);
	if (err != 0) {
		LOG_ERR("uart_configure: %d", err);
	}
#if defined(CONFIG_SLM_UART_HWFC_RUNTIME)
	/* Workaround to set HWFC dynamically */
#if defined(CONFIG_UART_0_NRF_HW_ASYNC_TIMER)
	if (hwfc) {
		nrf_uarte_hwfc_pins_set(NRF_UARTE0,
					DT_PROP(DT_NODELABEL(uart0), rts_pin),
					DT_PROP(DT_NODELABEL(uart0), cts_pin));
	} else {
		nrf_uarte_hwfc_pins_disconnect(NRF_UARTE0);
		nrf_gpio_pin_clear(DT_PROP(DT_NODELABEL(uart0), rts_pin));
		nrf_gpio_cfg_output(DT_PROP(DT_NODELABEL(uart0), rts_pin));
	}
#endif
#if defined(CONFIG_UART_2_NRF_HW_ASYNC_TIMER)
	if (hwfc) {
		nrf_uarte_hwfc_pins_set(NRF_UARTE2,
					DT_PROP(DT_NODELABEL(uart2), rts_pin),
					DT_PROP(DT_NODELABEL(uart2), cts_pin));
	} else {
		nrf_uarte_hwfc_pins_disconnect(NRF_UARTE2);
		nrf_gpio_pin_clear(DT_PROP(DT_NODELABEL(uart2), rts_pin));
		nrf_gpio_cfg_output(DT_PROP(DT_NODELABEL(uart2), rts_pin));
	}
#endif
#endif
	return err;
}

bool verify_datamode_control(uint16_t time_limit, uint16_t *min_time_limit)
{
	int min_time;

	if (slm_uart.baudrate == 0) {
		LOG_ERR("Baudrate not set");
		return false;
	}

	min_time = UART_RX_LEN * (8 + 1 + 1) * 1000 / slm_uart.baudrate;
	min_time += UART_RX_MARGIN_MS;

	if (time_limit > 0 && min_time > time_limit) {
		LOG_ERR("Invalid time_limit: %d, min: %d", time_limit, min_time);
		return false;
	}

	if (min_time_limit) {
		*min_time_limit = min_time;
	}

	return true;
}

static void response_handler(void *context, const char *response)
{
	int len = strlen(response);

	ARG_UNUSED(context);

	/* Forward the data over UART */
	if (slm_operation_mode == SLM_AT_COMMAND_MODE && len > 0) {
		rsp_send("\r\n", 2);
		rsp_send(response, len);
	}
}

static void raw_send(struct k_work *work)
{
	uint8_t *data = NULL;
	int size_send, size_sent;

	ARG_UNUSED(work);

	/* NOTE ring_buf_get_claim() might not return full size */
	do {
		size_send = ring_buf_get_claim(&data_rb, &data, sizeof(at_buf));
		if (data != NULL && size_send > 0) {
			LOG_INF("Raw send %d", size_send);
			LOG_HEXDUMP_DBG(data, MIN(size_send, HEXDUMP_DATAMODE_MAX), "RX-DATAMODE");
			if (datamode_handler) {
				size_sent = datamode_handler(DATAMODE_SEND, data, size_send);
				if (size_sent > 0) {
					(void)ring_buf_get_finish(&data_rb, size_sent);
				} else if (size_sent == 0) {
					(void)ring_buf_get_finish(&data_rb, size_send);
				} else {
#if defined(CONFIG_SLM_CUSTOMIZED)
/** Customization for customer project:
  * If DATAMODE_SEND fails, drop unsend data, quit datamode and send error URC right away
  */
					LOG_WRN("Raw send failed, %d dropped", size_send);
					(void)ring_buf_get_finish(&data_rb, size_send);
					(void)exit_datamode();
					rsp_send(ERROR_STR, sizeof(ERROR_STR) - 1);
					if (datamode_rx_disabled) {
						/* UART RX already resumed for command mode */
						datamode_rx_disabled = false;
					}
#else
					LOG_WRN("Raw send failed");
#endif
					break;
				}
			} else {
				LOG_WRN("no handler, %d dropped", size_send);
				(void)ring_buf_get_finish(&data_rb, size_send);
				break;
			}
		} else {
			break;
		}
	} while (true);

	/* resume UART RX in case of stopped by buffer full */
	if (datamode_rx_disabled) {
		(void)uart_receive();
		datamode_rx_disabled = false;
	}
}

static void inactivity_timer_handler(struct k_timer *timer)
{
	ARG_UNUSED(timer);

	LOG_INF("time limit reached");
	if (!ring_buf_is_empty(&data_rb)) {
		k_work_submit(&raw_send_work);
	} else {
		LOG_WRN("data buffer empty");
	}
}

K_TIMER_DEFINE(inactivity_timer, inactivity_timer_handler, NULL);

static void silence_timer_handler(struct k_timer *timer)
{
	ARG_UNUSED(timer);

	/* Drop pending data unconditionally */
	if (datamode_time_limit > 0) {
		k_timer_stop(&inactivity_timer);
	}

	/* quit datamode */
	if (datamode_handler) {
		(void)datamode_handler(DATAMODE_EXIT, NULL, 0);
		(void)exit_datamode();
	} else {
		LOG_WRN("missing datamode handler");
	}
	datamode_off_pending = false;
	/* send URC */
	rsp_send(OK_STR, sizeof(OK_STR) - 1);
}

K_TIMER_DEFINE(silence_timer, silence_timer_handler, NULL);

static int raw_rx_handler(const uint8_t *data, int datalen)
{
	int ret;
	const char *quit_str = CONFIG_SLM_DATAMODE_TERMINATOR;
	int quit_str_len = strlen(quit_str);
	int64_t silence = CONFIG_SLM_DATAMODE_SILENCE * MSEC_PER_SEC;
	static int64_t rx_start;

	/* First, check conditions for quitting datamode */
	if (silence > k_uptime_delta(&rx_start)) {
		if (datamode_off_pending) {
			/* quit procedure aborted */
			k_timer_stop(&silence_timer);
			datamode_off_pending = false;
			(void)ring_buf_put(&data_rb, quit_str, quit_str_len);
			LOG_INF("datamode off cancelled");
		}
	} else {
		/* leading silence confirmed */
		if (datalen == quit_str_len && strncmp(data, quit_str, quit_str_len) == 0) {
			datamode_off_pending = true;
			/* check subordinate silence */
			k_timer_start(&silence_timer, K_SECONDS(CONFIG_SLM_DATAMODE_SILENCE),
				      K_NO_WAIT);
			LOG_INF("datamode off pending");
			rx_start = k_uptime_get();
			return 0;
		}
	}

	if (datamode_time_limit > 0) {
		k_timer_stop(&inactivity_timer);
	}

	/* Second, save data to buffer */
	ret = ring_buf_put(&data_rb, data, datalen);
	if (ret != datalen) {
		LOG_ERR("enqueue data error (%d, %d)", datalen, ret);
		uart_rx_disable(uart_dev);
		return -1;
	}
	ret = ring_buf_space_get(&data_rb);
	if (ret < UART_RX_LEN) {
		LOG_WRN("data buffer full (%d)", ret);
		uart_rx_disable(uart_dev);
		return -1;
	}

	/* Third, start/restart inactivity timer, or trigger sending */
	if (datamode_time_limit > 0) {
		k_timer_start(&inactivity_timer, K_MSEC(datamode_time_limit), K_NO_WAIT);
	} else {
		k_work_submit(&raw_send_work);
	}

	rx_start = k_uptime_get();
	return 0;
}

/*
 * Check AT command grammar based on below.
 *  AT<NULL>
 *  AT<separator><body><NULL>
 *  AT<separator><body>=<NULL>
 *  AT<separator><body>?<NULL>
 *  AT<separator><body>=?<NULL>
 *  AT<separator><body>=<parameters><NULL>
 * In which
 * <separator>: +, %, #
 * <body>: alphanumeric char only, size > 0
 * <parameters>: arbitrary, size > 0
 */
static int cmd_grammar_check(const uint8_t *cmd, uint16_t length)
{
	const uint8_t *body;

	/* check AT (if not, no check) */
	if (length < 2 || toupper((int)cmd[0]) != 'A' || toupper((int)cmd[1]) != 'T') {
		return -EINVAL;
	}

	/* check AT<NULL> */
	cmd += 2;
	if (*cmd == '\0') {
		return 0;
	}

	/* check AT<separator> */
	if ((*cmd != '+') && (*cmd != '%') && (*cmd != '#')) {
		return -EINVAL;
	}

	/* check AT<separator><body> */
	cmd += 1;
	body = cmd;
	while (true) {
		/* check body is alphanumeric */
		if (!isalpha((int)*cmd) && !isdigit((int)*cmd)) {
			break;
		}
		cmd++;
	}

	/* check body size > 0 */
	if (cmd == body) {
		return -EINVAL;
	}

	/* check AT<separator><body><NULL> */
	if (*cmd == '\0') {
		return 0;
	}

	/* check AT<separator><body>= or check AT<separator><body>? */
	if (*cmd != '=' && *cmd != '?') {
		return -EINVAL;
	}

	/* check AT<separator><body>?<NULL> */
	if (*cmd == '?') {
		cmd += 1;
		if (*cmd == '\0') {
			return 0;
		} else {
			return -EINVAL;
		}
	}

	/* check AT<separator><body>=<NULL> */
	cmd += 1;
	if (*cmd == '\0') {
		return 0;
	}

	/* check AT<separator><body>=?<NULL> */
	if (*cmd == '?') {
		cmd += 1;
		if (*cmd == '\0') {
			return 0;
		} else {
			return -EINVAL;
		}
	}

	/* no need to check AT<separator><body>=<parameters><NULL> */
	return 0;
}

static void cmd_send(struct k_work *work)
{
	char str[32];
	enum at_cmd_state state;
	int err;

	ARG_UNUSED(work);

	if (at_buf_overflow) {
		rsp_send(ERROR_STR, sizeof(ERROR_STR) - 1);
		goto done;
	}

	LOG_HEXDUMP_DBG(at_buf, at_buf_len, "RX");

	if (cmd_grammar_check(at_buf, at_buf_len) != 0) {
		LOG_ERR("AT command invalid");
		rsp_send(ERROR_STR, sizeof(ERROR_STR) - 1);
		goto done;
	}

	err = slm_at_parse(at_buf);
	if (err == 0) {
		rsp_send(OK_STR, sizeof(OK_STR) - 1);
		goto done;
	} else if (err == -ESHUTDOWN) {
		/*Entered IDLE or UART Power Off */
		return;
	} else if (err != -ENOENT) {
		rsp_send(ERROR_STR, sizeof(ERROR_STR) - 1);
		goto done;
	}

	/* Send to modem */
	err = at_cmd_write(at_buf, at_buf, sizeof(at_buf), &state);
	if (err == -EAGAIN) {
		LOG_ERR("AT command timed out, indicating a modem issue");
		slm_util_reboot(3);

		CODE_UNREACHABLE;
		return;
	} else if (err) {
		LOG_ERR("AT command error: %d", err);
		state = AT_CMD_ERROR;
	}

	if (strlen(at_buf) > 0) {
		rsp_send("\r\n", 2);
		rsp_send(at_buf, strlen(at_buf));
	}

	switch (state) {
	case AT_CMD_OK:
		rsp_send(OK_STR, sizeof(OK_STR) - 1);
		break;
	case AT_CMD_ERROR:
		rsp_send(ERROR_STR, sizeof(ERROR_STR) - 1);
		break;
	case AT_CMD_ERROR_CMS:
		sprintf(str, "\r\n+CMS ERROR: %d\r\n", err);
		rsp_send(str, strlen(str));
		break;
	case AT_CMD_ERROR_CME:
		sprintf(str, "\r\n+CME ERROR: %d\r\n", err);
		rsp_send(str, strlen(str));
		break;
	case AT_CMD_ERROR_QUEUE:
	case AT_CMD_ERROR_WRITE:
	case AT_CMD_ERROR_READ:
#if defined(CONFIG_SLM_DIAG)
		slm_diag_set_event(SLM_DIAG_RADIO_FAIL);
#endif
		break;
	default:
		break;
	}

done:
	(void)uart_receive();
}

static int cmd_rx_handler(uint8_t character)
{
	static bool inside_quotes;
	static size_t at_cmd_len;

	/* Handle control characters */
	switch (character) {
	case 0x08: /* Backspace. */
		/* Fall through. */
	case 0x7F: /* DEL character */
		if (at_cmd_len > 0) {
			at_cmd_len--;
		}
		return 0;
	}

	/* Handle termination characters, if outside quotes. */
	if (!inside_quotes) {
		switch (character) {
		case '\r':
#if defined(CONFIG_SLM_CR_TERMINATION)
			goto send;
#else
			break;
#endif
		case '\n':
#if defined(CONFIG_SLM_LF_TERMINATION)
			goto send;
#elif defined(CONFIG_SLM_CR_LF_TERMINATION)
			if (at_cmd_len > 0 && at_buf[at_cmd_len - 1] == '\r') {
				at_cmd_len--; /* trim the CR char */
				goto send;
			}
#endif
			break;
		}
	}

	/* Write character to AT buffer */
	at_buf[at_cmd_len] = character;
	at_cmd_len++;

	/* Detect AT command buffer overflow, leaving space for null */
	if (at_cmd_len > sizeof(at_buf) - 1) {
		LOG_ERR("Buffer overflow");
		at_cmd_len--;
		at_buf_overflow = true;
		goto send;
	}

	/* Handle special written character */
	if (character == '"') {
		inside_quotes = !inside_quotes;
	}

	return 0;

send:
	uart_rx_disable(uart_dev);

	at_buf[at_cmd_len] = '\0';
	at_buf_len = at_cmd_len;
	k_work_submit(&cmd_send_work);

	inside_quotes = false;
	at_cmd_len = 0;
	if (at_buf_overflow) {
		return -1;
	}
	return 0;
}

static void uart_callback(const struct device *dev, struct uart_event *evt, void *user_data)
{
	int err;
	static uint16_t pos;
	static bool enable_rx_retry;

	ARG_UNUSED(dev);
	ARG_UNUSED(user_data);

	switch (evt->type) {
	case UART_TX_DONE:
		k_free(uart_tx_buf);
		k_sem_give(&tx_done);
		break;
	case UART_TX_ABORTED:
		k_free(uart_tx_buf);
		k_sem_give(&tx_done);
		LOG_INF("TX_ABORTED");
		break;
	case UART_RX_RDY:
		if (slm_operation_mode == SLM_AT_COMMAND_MODE) {
			for (int i = pos; i < (pos + evt->data.rx.len); i++) {
				err = cmd_rx_handler(evt->data.rx.buf[i]);
				if (err) {
					return;
				}
			}
		} else if (slm_operation_mode == SLM_DATA_MODE) {
			LOG_DBG("RX_RDY %d", evt->data.rx.len);
			err = raw_rx_handler(&(evt->data.rx.buf[pos]), evt->data.rx.len);
			if (err) {
				return;
			}
		} else {
			LOG_WRN("No handler");
		}
		pos += evt->data.rx.len;
		break;
	case UART_RX_BUF_REQUEST:
		pos = 0;
		err = uart_rx_buf_rsp(uart_dev, next_buf, sizeof(uart_rx_buf[0]));
		if (err) {
			LOG_WRN("UART RX buf rsp: %d", err);
		}
		break;
	case UART_RX_BUF_RELEASED:
		next_buf = evt->data.rx_buf.buf;
		break;
	case UART_RX_STOPPED:
		LOG_WRN("RX_STOPPED (%d)", evt->data.rx_stop.reason);
		/* Retry automatically in case of UART ERROR interrupt */
		if (evt->data.rx_stop.reason != 0) {
			enable_rx_retry = true;
		}
		break;
	case UART_RX_DISABLED:
		LOG_DBG("RX_DISABLED");
		if (slm_operation_mode == SLM_DATA_MODE) {
			datamode_rx_disabled = true;
			/* flush data in ring-buffer, if any */
			k_work_submit(&raw_send_work);
		}
		if (enable_rx_retry && !uart_recovery_pending) {
			k_work_schedule(&uart_recovery_work, K_MSEC(UART_ERROR_DELAY_MS));
			enable_rx_retry = false;
			uart_recovery_pending = true;
		}
		break;
	default:
		break;
	}
}

int slm_at_host_init(void)
{
	int err;
	uint32_t start_time;
	uint32_t rr = 0;

	/* Initialize the UART module */
#if defined(CONFIG_SLM_CONNECT_UART_0)
	uart_dev = device_get_binding(DT_LABEL(DT_NODELABEL(uart0)));
#elif defined(CONFIG_SLM_CONNECT_UART_2)
	uart_dev = device_get_binding(DT_LABEL(DT_NODELABEL(uart2)));
#else
	LOG_ERR("Unsupported UART instance");
	return -EINVAL;
#endif
	if (uart_dev == NULL) {
		LOG_ERR("Cannot bind UART device\n");
		return -EINVAL;
	}
	/* Save UART configuration to setting page */
	if (!uart_configured) {
		err = uart_config_get(uart_dev, &slm_uart);
		if (err != 0) {
			LOG_ERR("uart_config_get: %d", err);
			return err;
		}
		err = slm_setting_uart_save();
		if (err != 0) {
			LOG_ERR("uart_config_get: %d", err);
			return err;
		}
		uart_configured = true;
	} else {
		/* else re-config UART based on setting page */
		LOG_INF("UART baud: %d d/p/s-bits: %d/%d/%d HWFC: %d",
			slm_uart.baudrate, slm_uart.data_bits, slm_uart.parity,
			slm_uart.stop_bits, slm_uart.flow_ctrl);
		err = slm_uart_configure(slm_uart.baudrate, slm_uart.flow_ctrl);
		if (err != 0) {
			LOG_ERR("Fail to set uart baudrate: %d", err);
			return err;
		}
	}
	/* Wait for the UART line to become valid */
	start_time = k_uptime_get_32();
	do {
		err = uart_err_check(uart_dev);
		if (err) {
			uint32_t now = k_uptime_get_32();

			if (now - start_time > UART_ERROR_DELAY_MS) {
				LOG_ERR("UART check failed: %d", err);
				return -EIO;
			}
			k_sleep(K_MSEC(10));
		}
	} while (err);
	/* Register async handling callback */
	err = uart_callback_set(uart_dev, uart_callback, NULL);
	if (err) {
		LOG_ERR("Cannot set callback: %d", err);
		return -EFAULT;
	}
	/* Power on UART module */
	pm_device_state_set(uart_dev, PM_DEVICE_STATE_ACTIVE, NULL, NULL);
	err = uart_receive();
	if (err) {
		return -EFAULT;
	}

	err = at_notif_register_handler(NULL, response_handler);
	if (err) {
		LOG_ERR("Can't register handler: %d", err);
		return err;
	}

	/* Initialize AT Parser */
	err = at_params_list_init(&at_param_list, CONFIG_SLM_AT_MAX_PARAM);
	if (err) {
		LOG_ERR("Failed to init AT Parser: %d", err);
		return err;
	}

	datamode_time_limit = 0;
	datamode_handler = NULL;

	err = slm_at_init();
	if (err) {
		return -EFAULT;
	}

	k_work_init(&raw_send_work, raw_send);
	k_work_init(&cmd_send_work, cmd_send);
	k_work_init_delayable(&uart_recovery_work, uart_recovery);
	k_sem_give(&tx_done);
	rr = nrf_power_resetreas_get(NRF_POWER_NS);
	LOG_DBG("RR: 0x%08x", rr);
	if (rr & NRF_POWER_RESETREAS_DOG_MASK) {
		nrf_power_resetreas_clear(NRF_POWER_NS, NRF_POWER_RESETREAS_DOG_MASK);
#if defined(CONFIG_SLM_CUSTOMIZED_RS232)
		nrf_gpio_pin_set(CONFIG_SLM_RI_PIN);
		nrf_gpio_cfg_output(CONFIG_SLM_RI_PIN);
		k_sleep(K_MSEC(CONFIG_SLM_RI_ON_DURATION));
		nrf_gpio_pin_clear(CONFIG_SLM_RI_PIN);
		nrf_gpio_cfg_output(CONFIG_SLM_RI_PIN);
		k_sleep(K_MSEC(CONFIG_SLM_RI_OFF_DURATION));
		k_sleep(K_MSEC(CONFIG_SLM_POST_RI_DURATION));
#endif
		rsp_send(SLM_WDRESET_STR, sizeof(SLM_WDRESET_STR)-1);
	} else {
		rsp_send(SLM_SYNC_STR, sizeof(SLM_SYNC_STR)-1);
	}
	slm_fota_post_process();

	slm_operation_mode = SLM_AT_COMMAND_MODE;
	LOG_DBG("at_host init done");
	return err;
}

void slm_at_host_uninit(void)
{
	int err;

	if (slm_operation_mode == SLM_DATA_MODE) {
		k_timer_stop(&silence_timer);
		k_timer_stop(&inactivity_timer);
	}
	datamode_handler = NULL;

	slm_at_uninit();

	err = at_notif_deregister_handler(NULL, response_handler);
	if (err) {
		LOG_WRN("Can't deregister handler: %d", err);
	}

	/* Power off UART module */
	uart_rx_disable(uart_dev);
	k_sleep(K_MSEC(100));
	err = pm_device_state_set(uart_dev, PM_DEVICE_STATE_OFF, NULL, NULL);
	if (err) {
		LOG_WRN("Can't power off uart: %d", err);
	}

	LOG_DBG("at_host uninit done");
}
```

## src/watchdog.c
```c
/*
 * Copyright (c) 2025 Nordic Semiconductor ASA
 *
 * SPDX-License-Identifier: LicenseRef-Nordic-5-Clause
 */

#include <zephyr.h>
#include <device.h>
#include <drivers/watchdog.h>
#include <sys/reboot.h>
#include <task_wdt/task_wdt.h>
#include <logging/log.h>

#include "slm_util.h"
#include "watchdog.h"

LOG_MODULE_REGISTER(watchdog, CONFIG_SLM_LOG_LEVEL);

/* Create a delayed work that continuously feeds the watchdog on the system work queue.
 * The system work queue is also used for sending AT commands to the modem, so a watchdog
 * timeout will be triggered if the modem is unresponsive.
 */
static void feed_watchdog_work_fn(struct k_work *work);
static K_WORK_DELAYABLE_DEFINE(feed_watchdog_work, feed_watchdog_work_fn);
static int sys_workqueue_wd_channel_id;

static void sys_workqueue_watchdog_callback(int channel_id, void *user_data)
{
	ARG_UNUSED(channel_id);
	ARG_UNUSED(user_data);

	LOG_ERR("System workqueue watchdog");

	slm_util_reboot(3);
}

static void feed_watchdog_work_fn(struct k_work *work)
{
	int err;

	ARG_UNUSED(work);

	LOG_DBG("Feeding watchdog");

	err = task_wdt_feed(sys_workqueue_wd_channel_id);
	if (err) {
		LOG_ERR("task_wdt_feed() error: %d", err);
	}

	/* Feed the watchdog */
	k_work_reschedule(&feed_watchdog_work,
			  K_MSEC(WATCHDOG_SYSTEM_WORKQUEUE_FEED_INTERVAL_MSEC));
}

static int init_task_watchdog(const struct device *unused)
{
	int err;

	ARG_UNUSED(unused);

	const struct device *dev = device_get_binding(DT_LABEL(DT_NODELABEL(wdt)));
	if (!dev) {
		LOG_ERR("WDT not available");
	}

	err = task_wdt_init(dev);

	if (err) {
		LOG_ERR("task_wdt_init() error: %d", err);
	}

	/* Initialize and start feeding the watchdog on the system workqueue */
	sys_workqueue_wd_channel_id =
		task_wdt_add(CONFIG_SLM_WATCHDOG_SYSTEM_WORKQUEUE_TIMEOUT_MSEC,
			     sys_workqueue_watchdog_callback, NULL);
	if (sys_workqueue_wd_channel_id < 0) {
		LOG_ERR("task_wdt_add() error: %d", sys_workqueue_wd_channel_id);
		return -ENXIO;
	}

	k_work_reschedule(&feed_watchdog_work, K_NO_WAIT);

	return 0;
}

SYS_INIT(init_task_watchdog, POST_KERNEL, CONFIG_APPLICATION_INIT_PRIORITY);
```
